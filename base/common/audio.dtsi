/* From stock msm8937-audio.dtsi */
&int_codec {
	qcom,msm-mbhc-hphl-swh = <1>;
	qcom,msm-mbhc-gnd-swh = <1>;
	qcom,msm-hs-micbias-type = "internal";

	/delete-property/ qcom,cdc-us-eu-gpios;
	/delete-property/ qcom,quin-mi2s-gpios;

	/delete-property/ asoc-wsa-codec-names;
	/delete-property/ asoc-wsa-codec-prefixes;
	/delete-property/ msm-vdd-wsa-switch-supply;
	/delete-property/ qcom,msm-vdd-wsa-switch-voltage;
	/delete-property/ qcom,msm-vdd-wsa-switch-current;
};

&wsa881x_i2c_f {
	status = "disabled";
};

/* From stock sdm439-audio.dtsi */
&int_codec {
	/delete-property/ qcom,msm-micbias2-ext-cap;
	qcom,wsa-disabled;
	/delete-property/ msm-vdd-wsa-switch-supply;
	/delete-property/ qcom,msm-vdd-wsa-switch-voltage;
	/delete-property/ qcom,msm-vdd-wsa-switch-current;
};

/* Adapted from stock msm-analog-cdc.c */
&pmic_analog_codec {
	qcom,cdc-micbias-cfilt-mv = <2200000>;
};
