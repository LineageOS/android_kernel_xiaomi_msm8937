&i2c_2 {
	aw87519@58{
		status = "okay";
		compatible = "awinic,aw87519";
		reg = <0x58>;
		reset-gpio = <&tlmm 125 0x01>;
	};
};

&int_codec {
	/* WARNING: Override
	   Changes:
	   - "MIC BIAS External2", "Headset Mic", => "MIC BIAS Internal2", "Headset Mic",
	   - "AMIC2", "MIC BIAS External2", => "AMIC2", "MIC BIAS Internal2",
	   - Remove "WSA_SPK OUT", "VDD_WSA_SWITCH",
	   - Remove "SpkrMono WSA_IN", "WSA_SPK OUT"
	   - Add "MI439 AW87329 PA SPK", "LINEOUT PA";
	*/
	qcom,audio-routing =
			"RX_BIAS", "MCLK",
			"SPK_RX_BIAS", "MCLK",
			"INT_LDO_H", "MCLK",
			"RX_I2S_CLK", "MCLK",
			"TX_I2S_CLK", "MCLK",
			"MIC BIAS External", "Handset Mic",
			"MIC BIAS Internal2", "Headset Mic",
			"MIC BIAS External", "Secondary Mic",
			"AMIC1", "MIC BIAS External",
			"AMIC2", "MIC BIAS Internal2",
			"AMIC3", "MIC BIAS External",
			"ADC1_IN", "ADC1_OUT",
			"ADC2_IN", "ADC2_OUT",
			"ADC3_IN", "ADC3_OUT",
			"PDM_IN_RX1", "PDM_OUT_RX1",
			"PDM_IN_RX2", "PDM_OUT_RX2",
			"PDM_IN_RX3", "PDM_OUT_RX3",
			"MI439 AW87519 PA SPK", "LINEOUT PA";
};

&wsa881x_i2c_45 {
	status = "disabled";
};
