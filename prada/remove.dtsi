&tlmm {
	/delete-node/ cdc_reset_ctrl;
	/delete-node/ cross-conn-det;
	/delete-node/ pri-tlmm-lines;
	/delete-node/ pri-tlmm-ws-lines;
};

&flash_led {
	/delete-property/ pinctrl-0;
	/delete-property/ pinctrl-1;
	/delete-property/ pinctrl-names;
	/delete-node/ qcom,flash_1;
	/delete-node/ qcom,switch;
	/delete-node/ qcom,torch_1;
};
