&mtp_batterydata {
	/delete-node/ qcom,ascent-3450mah;
	/delete-node/ qcom,itech-3000mah;
	#include "batterydata/coslight-4000mah.dtsi"
	#include "batterydata/scud-4000mah.dtsi"
};

&qpnp_smbcharger {
#ifdef CONFIG_QPNP_SMBCHARGER_MI8937
	compatible = "qcom,qpnp-smbcharger-mi8937";
#endif

	/delete-property/ qcom,chg-led-support;
	qcom,fastchg-current-comp = <1200>;
	qcom,float-voltage-comp = <11>;
	qcom,float-voltage-mv = <4400>;
	qcom,iterm-ma = <200>;
};

&qpnp_fg {
#ifdef CONFIG_QPNP_FG_MI8937
	compatible = "qcom,qpnp-fg-mi8937";
#endif

	qcom,cold-bat-decidegc = <0>;
	qcom,cool-bat-decidegc = <100>;
	qcom,fg-chg-iterm-ma = <200>;
	qcom,fg-delta-soc = <1>;
	qcom,fg-iterm-ma = <250>;
	qcom,fg-vbat-estimate-diff-mv = <200>;
	qcom,hold-soc-while-full;
	qcom,hot-bat-decidegc = <600>;
	qcom,resume-soc-raw = <254>;
	qcom,warm-bat-decidegc = <450>;
};
