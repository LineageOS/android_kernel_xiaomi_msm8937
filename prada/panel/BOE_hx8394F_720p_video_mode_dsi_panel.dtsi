&mdss_mdp {
	dsi_hx8394f_boe_720p_video: qcom,mdss_dsi_hx8394f_boe_720p_video {
		xiaomi,panel-id = <0>;
		qcom,mdss-dsi-panel-name = "BOE_hx8394F_720p_video_mode_dsi_panel";
		qcom,mdss-dsi-panel-controller = <&mdss_dsi0>;
		qcom,mdss-dsi-panel-type = "dsi_video_mode";
		qcom,mdss-dsi-panel-destination = "display_1";
		qcom,mdss-dsi-panel-framerate = <0x3c>;
		qcom,mdss-dsi-virtual-channel-id = <0>;
		qcom,mdss-dsi-stream = <0>;
		qcom,mdss-dsi-panel-width = <0x2d0>;
		qcom,mdss-dsi-panel-height = <0x500>;
		qcom,mdss-dsi-h-front-porch = <0x9c>;
		qcom,mdss-dsi-h-back-porch = <0x9c>;
		qcom,mdss-dsi-h-pulse-width = <0x18>;
		qcom,mdss-dsi-h-sync-skew = <0>;
		qcom,mdss-dsi-v-back-porch = <0xc>;
		qcom,mdss-dsi-v-front-porch = <0xf>;
		qcom,mdss-dsi-v-pulse-width = <0x4>;
		qcom,mdss-dsi-h-left-border = <0>;
		qcom,mdss-dsi-h-right-border = <0>;
		qcom,mdss-dsi-v-top-border = <0>;
		qcom,mdss-dsi-v-bottom-border = <0>;
		qcom,mdss-dsi-bpp = <0x18>;
		qcom,mdss-dsi-underflow-color = <0xff>;
		qcom,mdss-dsi-border-color = <0>;
		qcom,mdss-dsi-on-command = [29 01 00 00 00 00 04 b9 ff 83 94 05 01 00 00 78 00 02 11 00 05 01 00 00 0a 00 02 29 00 29 01 00 00 00 00 04 c9 13 00 1c 29 01 00 00 00 00 02 51 ff 29 01 00 00 00 00 02 53 2c 29 01 00 00 00 00 02 55 00];
		qcom,mdss-dsi-off-command = [05 01 00 00 32 00 02 28 00 05 01 00 00 05 00 02 10 00];
		qcom,mdss-dsi-ct-warm-command = [29 01 00 00 00 00 3b e0 07 08 09 0d 10 14 16 13 24 36 48 4a 58 6f 76 80 97 a5 a8 b5 c6 62 63 68 6f 72 78 7f 7f 00 02 08 0d 0c 0e 0f 10 24 36 48 4a 58 6f 78 82 99 a4 a0 b1 c0 5e 5e 64 6b 6c 73 7f 7f 29 00 00 00 00 00 02 bd 00 29 00 00 00 00 00 2c c1 01 00 0c 18 24 30 3a 43 4a 52 59 5f 66 6d 74 7b 82 8a 91 99 9f a6 ad b4 bb c2 ca d1 d8 e0 e7 ef f7 ff 16 f3 09 6b 02 9d 96 aa c0 29 00 00 00 00 00 02 bd 01 29 00 00 00 00 00 2b c1 00 0b 16 21 2c 36 3e 46 4d 53 5a 5f 65 6c 72 79 7f 85 8c 92 9a a0 a6 ac b2 b8 bf c5 cc d2 d8 df e6 06 8c 33 ed bb 00 f2 6f 80 29 00 00 00 00 00 02 bd 02 29 00 00 00 00 00 2b c1 00 09 13 1d 27 31 3a 41 48 4f 55 5b 60 66 6c 72 78 7e 84 8a 90 96 9c a2 a7 ad b3 b9 be c4 cb d0 d6 39 13 84 56 44 6c e8 f2 80 29 01 00 00 00 00 02 bd 00];
		qcom,mdss-dsi-ct-cold-command = [29 01 00 00 00 00 3b e0 07 08 09 0d 10 14 16 13 24 36 48 4a 58 6f 76 80 97 a5 a8 b5 c6 62 63 68 6f 72 78 7f 7f 00 02 08 0d 0c 0e 11 10 24 36 48 4a 58 6f 78 82 99 a4 a0 b1 c0 5e 5e 64 6b 6c 73 7f 7f 29 00 00 00 00 00 02 bd 00 29 00 00 00 00 00 2c c1 01 00 0a 14 1f 29 32 3c 44 4c 53 59 60 66 6e 74 7c 83 8b 92 9b a1 a9 b0 b7 be c6 ce d6 dd e6 ee f7 ff 2c 66 0c cc 8c c5 f8 d8 c0 29 00 00 00 00 00 02 bd 01 29 00 00 00 00 00 2b c1 00 0a 14 1e 28 31 3b 43 4a 51 58 5e 65 6c 72 79 80 87 8f 97 9e a4 ab b3 b9 c0 c8 cf d6 de e5 ed f6 00 21 bb 0e b4 38 ba cf 40 29 00 00 00 00 00 02 bd 02 29 00 00 00 00 00 2b c1 00 09 13 1d 26 30 3a 43 4a 51 58 5e 65 6c 73 7a 81 88 8f 97 9e a5 ac b3 b9 c1 c8 cf d6 dd e5 ec f4 34 b8 bb 50 1e 91 ce b7 c0 29 01 00 00 00 00 02 bd 00];
		qcom,mdss-dsi-ct-normal-command = [29 01 00 00 00 00 3b e0 07 08 09 0d 10 14 16 13 24 36 48 4a 58 6f 76 80 97 a5 a8 b5 c6 62 63 68 6f 72 78 7f 7f 00 02 08 0d 0c 0e 0f 10 24 36 48 4a 58 6f 78 82 99 a4 a0 b1 c0 5e 5e 64 6b 6c 73 7f 7f 29 00 00 00 00 00 02 bd 00 29 00 00 00 00 00 2c c1 01 00 0a 14 1f 29 33 3c 44 4c 53 59 60 67 6e 75 7c 83 8b 93 9b a1 a8 b0 b7 be c6 ce d6 dd e6 ee f7 ff 2c 8a 0d 11 90 f7 f8 c8 c0 29 00 00 00 00 00 02 bd 01 29 00 00 00 00 00 2b c1 00 09 13 1d 26 30 39 41 49 50 56 5c 62 69 70 76 7d 84 8b 92 9a a0 a7 ae b4 bb c2 ca d0 d7 df e6 ee 24 db 0b e3 56 60 e9 f7 c0 29 00 00 00 00 00 02 bd 02 29 00 00 00 00 00 2b c1 00 09 11 1a 23 2e 37 3f 47 4e 54 5b 60 67 6d 74 7a 81 88 8f 96 9d a3 a9 b0 b6 bd c4 cb d1 d8 df e6 0f c7 48 d9 90 47 75 a5 80 29 01 00 00 00 00 02 bd 00];
		qcom,mdss-dsi-eyecare1-command = [29 01 00 00 00 00 3b e0 07 08 09 0d 10 14 16 13 24 36 48 4a 58 6f 76 80 97 a5 a8 b5 c6 62 63 68 6f 72 78 7f 7f 00 02 08 0d 0c 0e 0f 10 24 36 48 4a 58 6f 78 82 99 a4 a0 b1 c0 5e 5e 64 6b 6c 73 7f 7f 29 00 00 00 00 00 02 bd 00 29 00 00 00 00 00 2c c1 01 00 0a 14 1e 28 32 3b 43 4a 52 58 5f 65 6d 74 7b 82 8a 92 99 a1 a8 ae b6 be c5 cd d6 dc e5 ed f6 ff 15 8f c9 c5 97 4f 3c cb c0 29 00 00 00 00 00 02 bd 01 29 00 00 00 00 00 2b c1 00 09 13 1d 26 30 39 41 48 4f 55 5c 62 68 6f 76 7d 84 8b 92 9a a0 a7 ae b5 bc c3 cb d2 d9 e0 e7 ef 24 85 5c 39 07 79 44 1a 80 29 00 00 00 00 00 02 bd 02 29 00 00 00 00 00 2b c1 00 08 10 19 21 2b 34 3c 43 49 50 56 5b 61 67 6e 74 7a 80 87 8e 94 9a a0 a7 ad b3 ba c0 c6 cd d3 da 2d e5 b1 bc 2e 7f 14 e2 80 29 01 00 00 00 00 02 bd 00];
		qcom,mdss-dsi-eyecare2-command = [29 01 00 00 00 00 3b e0 07 08 09 0d 10 14 16 13 24 36 48 4a 58 6f 76 80 97 a5 a8 b5 c6 62 63 68 6f 72 78 7f 7f 00 02 08 0d 0c 0e 0f 10 24 36 48 4a 58 6f 78 82 99 a4 a0 b1 c0 5e 5e 64 6b 6c 73 7f 7f 29 00 00 00 00 00 02 bd 00 29 00 00 00 00 00 2c c1 01 00 0a 14 1e 28 32 3b 43 4a 52 58 5f 65 6d 74 7b 82 8a 92 99 a1 a8 ae b6 be c5 cd d6 dc e5 ed f6 ff 15 8f c9 c5 97 4f 3c cb c0 29 00 00 00 00 00 02 bd 01 29 00 00 00 00 00 2b c1 00 09 13 1d 26 30 39 41 48 4f 55 5c 62 68 6f 76 7d 84 8b 92 9a a0 a7 ae b5 bc c3 cb d2 d9 e0 e7 ef 24 85 5c 39 07 79 44 1a 80 29 00 00 00 00 00 02 bd 02 29 00 00 00 00 00 2b c1 00 08 10 18 20 29 31 39 40 46 4c 52 57 5d 62 69 6e 74 7a 81 87 8d 93 99 9f a5 aa b1 b7 bd c3 c9 d0 00 6e 54 5c ac b5 0d c6 00 29 01 00 00 00 00 02 bd 00];
		qcom,mdss-dsi-eyecare3-command = [29 01 00 00 00 00 3b e0 07 08 09 0d 10 14 16 13 24 36 48 4a 58 6f 76 80 97 a5 a8 b5 c6 62 63 68 6f 72 78 7f 7f 00 02 08 0d 0c 0e 0f 10 24 36 48 4a 58 6f 78 82 99 a4 a0 b1 c0 5e 5e 64 6b 6c 73 7f 7f 29 00 00 00 00 00 02 bd 00 29 00 00 00 00 00 2c c1 01 00 0a 14 1e 28 32 3b 43 4a 52 58 5f 65 6d 74 7b 82 8a 92 99 a1 a8 ae b6 be c5 cd d6 dc e5 ed f6 ff 15 8f c9 c5 97 4f 3c cb c0 29 00 00 00 00 00 02 bd 01 29 00 00 00 00 00 2b c1 00 09 13 1d 26 30 39 41 48 4f 55 5c 62 68 6f 76 7d 84 8b 92 9a a0 a7 ae b5 bc c3 cb d2 d9 e0 e7 ef 24 85 5c 39 07 79 44 1a 80 29 00 00 00 00 00 02 bd 02 29 00 00 00 00 00 2b c1 00 07 0f 16 1e 27 2f 36 3c 42 48 4d 52 58 5d 63 68 6e 73 79 80 85 8b 90 96 9b a1 a7 ad b2 b8 be c4 23 41 92 44 4f 32 35 65 40 29 01 00 00 00 00 02 bd 00];
		qcom,mdss-dsi-eyecare4-command = [29 01 00 00 00 00 3b e0 07 08 09 0d 10 14 16 13 24 36 48 4a 58 6f 76 80 97 a5 a8 b5 c6 62 63 68 6f 72 78 7f 7f 00 02 08 0d 0c 0e 0f 10 24 36 48 4a 58 6f 78 82 99 a4 a0 b1 c0 5e 5e 64 6b 6c 73 7f 7f 29 00 00 00 00 00 02 bd 00 29 00 00 00 00 00 2c c1 01 00 0a 14 1e 28 32 3b 43 4a 52 58 5f 65 6d 74 7b 82 8a 92 99 a1 a8 ae b6 be c5 cd d6 dc e5 ed f6 ff 15 8f c9 c5 97 4f 3c cb c0 29 00 00 00 00 00 02 bd 01 29 00 00 00 00 00 2b c1 00 09 13 1d 26 30 39 41 48 4f 55 5c 62 68 6f 76 7d 84 8b 92 9a a0 a7 ae b5 bc c3 cb d2 d9 e0 e7 ef 24 85 5c 39 07 79 44 1a 80 29 00 00 00 00 00 02 bd 02 29 00 00 00 00 00 2b c1 00 07 0e 15 1c 25 2c 33 39 3e 44 49 4d 53 58 5d 62 68 6d 73 79 7e 83 88 8d 93 98 9e a3 a8 ae b3 b9 06 c9 71 c2 88 16 c4 e3 80 29 01 00 00 00 00 02 bd 00];
		qcom,mdss-dsi-eyecare5-command = [29 01 00 00 00 00 3b e0 07 08 09 0d 10 14 16 13 24 36 48 4a 58 6f 76 80 97 a5 a8 b5 c6 62 63 68 6f 72 78 7f 7f 00 02 08 0d 0c 0e 0f 10 24 36 48 4a 58 6f 78 82 99 a4 a0 b1 c0 5e 5e 64 6b 6c 73 7f 7f 29 00 00 00 00 00 02 bd 00 29 00 00 00 00 00 2c c1 01 00 0a 14 1e 28 32 3b 43 4a 52 58 5f 65 6d 74 7b 82 8a 92 99 a1 a8 ae b6 be c5 cd d6 dc e5 ed f6 ff 15 8f c9 c5 97 4f 3c cb c0 29 00 00 00 00 00 02 bd 01 29 00 00 00 00 00 2b c1 00 09 13 1d 26 30 39 41 48 4f 55 5c 62 68 6f 76 7d 84 8b 92 9a a0 a7 ae b5 bc c3 cb d2 d9 e0 e7 ef 24 85 5c 39 07 79 44 1a 80 29 00 00 00 00 00 02 bd 02 29 00 00 00 00 00 2b c1 00 06 0d 14 1a 22 29 30 35 3a 3f 44 49 4d 52 57 5c 61 66 6b 71 76 7b 80 85 89 8e 94 99 9e a3 a8 ad 34 e8 fe 3a 6b 50 3c 81 c0 29 01 00 00 00 00 02 bd 00];
		qcom,mdss-dsi-eyecare6-command = [29 01 00 00 00 00 3b e0 07 08 09 0d 10 14 16 13 24 36 48 4a 58 6f 76 80 97 a5 a8 b5 c6 62 63 68 6f 72 78 7f 7f 00 02 08 0d 0c 0e 0f 10 24 36 48 4a 58 6f 78 82 99 a4 a0 b1 c0 5e 5e 64 6b 6c 73 7f 7f 29 00 00 00 00 00 02 bd 00 29 00 00 00 00 00 2c c1 01 00 0a 14 1e 28 32 3b 43 4a 52 58 5f 65 6d 74 7b 82 8a 92 99 a1 a8 ae b6 be c5 cd d6 dc e5 ed f6 ff 15 8f c9 c5 97 4f 3c cb c0 29 00 00 00 00 00 02 bd 01 29 00 00 00 00 00 2b c1 00 09 13 1d 26 30 39 41 48 4f 55 5c 62 68 6f 76 7d 84 8b 92 9a a0 a7 ae b5 bc c3 cb d2 d9 e0 e7 ef 24 85 5c 39 07 79 44 1a 80 29 00 00 00 00 00 02 bd 02 29 00 00 00 00 00 2b c1 00 06 0c 13 19 20 27 2d 32 37 3c 40 44 49 4d 52 57 5b 60 65 6a 6f 74 78 7d 82 86 8b 90 95 99 9e a4 18 65 a3 de 3f e3 4a cf 00 29 01 00 00 00 00 02 bd 00];
		qcom,mdss-dsi-eyecare7-command = [29 01 00 00 00 00 3b e0 07 08 09 0d 10 14 16 13 24 36 48 4a 58 6f 76 80 97 a5 a8 b5 c6 62 63 68 6f 72 78 7f 7f 00 02 08 0d 0c 0e 0f 10 24 36 48 4a 58 6f 78 82 99 a4 a0 b1 c0 5e 5e 64 6b 6c 73 7f 7f 29 00 00 00 00 00 02 bd 00 29 00 00 00 00 00 2c c1 01 00 0a 14 1e 28 32 3b 43 4a 52 58 5f 65 6d 74 7b 82 8a 92 99 a1 a8 ae b6 be c5 cd d6 dc e5 ed f6 ff 15 8f c9 c5 97 4f 3c cb c0 29 00 00 00 00 00 02 bd 01 29 00 00 00 00 00 2b c1 00 09 13 1d 26 30 39 41 48 4f 55 5c 62 68 6f 76 7d 84 8b 92 9a a0 a7 ae b5 bc c3 cb d2 d9 e0 e7 ef 24 85 5c 39 07 79 44 1a 80 29 00 00 00 00 00 02 bd 02 29 00 00 00 00 00 2b c1 00 05 0b 11 17 1e 24 2a 2f 33 38 3c 40 44 48 4d 51 55 5a 5f 63 68 6c 70 75 79 7d 82 87 8b 8f 94 99 3f e9 71 6d 74 db 1d 59 00 29 01 00 00 00 00 02 bd 00];
		qcom,mdss-dsi-eyecare8-command = [29 01 00 00 00 00 3b e0 07 08 09 0d 10 14 16 13 24 36 48 4a 58 6f 76 80 97 a5 a8 b5 c6 62 63 68 6f 72 78 7f 7f 00 02 08 0d 0c 0e 0f 10 24 36 48 4a 58 6f 78 82 99 a4 a0 b1 c0 5e 5e 64 6b 6c 73 7f 7f 29 00 00 00 00 00 02 bd 00 29 00 00 00 00 00 2c c1 01 00 0a 14 1e 28 32 3b 43 4a 52 58 5f 65 6d 74 7b 82 8a 92 99 a1 a8 ae b6 be c5 cd d6 dc e5 ed f6 ff 15 8f c9 c5 97 4f 3c cb c0 29 00 00 00 00 00 02 bd 01 29 00 00 00 00 00 2b c1 00 09 13 1d 26 30 39 41 48 4f 55 5c 62 68 6f 76 7d 84 8b 92 9a a0 a7 ae b5 bc c3 cb d2 d9 e0 e7 ef 24 85 5c 39 07 79 44 1a 80 29 00 00 00 00 00 02 bd 02 29 00 00 00 00 00 2b c1 00 05 0a 10 16 1c 22 27 2c 30 34 38 3b 3f 43 47 4b 4f 54 58 5c 60 64 68 6c 70 74 79 7d 81 85 89 8e 2e 11 00 fb b1 ff fc 9b 40 29 01 00 00 00 00 02 bd 00];
		qcom,mdss-dsi-ce-off-command = [29 01 00 00 0a 00 03 e4 01 00];
		qcom,mdss-dsi-ce-on-command = [29 01 00 00 0a 00 03 e4 01 41 29 01 00 00 0a 00 12 e6 00 00 00 05 05 06 00 00 20 20 20 20 20 20 20 10 06];
		qcom,mdss-dsi-cabc-off-command = [29 01 00 00 00 00 02 51 ff 29 01 00 00 00 00 02 53 2c 29 01 00 00 00 00 02 55 00];
		qcom,mdss-dsi-cabc-ui-command = [29 01 00 00 00 00 02 51 ff 29 01 00 00 00 00 02 53 2c 29 01 00 00 00 00 02 55 01];
		qcom,mdss-dsi-cabc-still-command = [29 01 00 00 00 00 04 c9 13 00 1c 29 01 00 00 00 00 02 51 ff 29 01 00 00 00 00 02 53 2c 29 01 00 00 00 00 02 55 02];
		qcom,mdss-dsi-cabc-moving-command = [29 01 00 00 00 00 04 c9 13 00 1c 29 01 00 00 00 00 02 51 ff 29 01 00 00 00 00 02 53 2c 29 01 00 00 00 00 02 55 03];
		qcom,mdss-dsi-on-command-state = "dsi_lp_mode";
		qcom,mdss-dsi-off-command-state = "dsi_hs_mode";
		qcom,mdss-dsi-ct-warm-command-state = "dsi_hs_mode";
		qcom,mdss-dsi-ct-cold-command-state = "dsi_hs_mode";
		qcom,mdss-dsi-ct-normal-command-state = "dsi_hs_mode";
		qcom,mdss-dsi-eyecare1-command-state = "dsi_hs_mode";
		qcom,mdss-dsi-eyecare2-command-state = "dsi_hs_mode";
		qcom,mdss-dsi-eyecare3-command-state = "dsi_hs_mode";
		qcom,mdss-dsi-eyecare4-command-state = "dsi_hs_mode";
		qcom,mdss-dsi-eyecare5-command-state = "dsi_hs_mode";
		qcom,mdss-dsi-eyecare6-command-state = "dsi_hs_mode";
		qcom,mdss-dsi-eyecare7-command-state = "dsi_hs_mode";
		qcom,mdss-dsi-eyecare8-command-state = "dsi_hs_mode";
		qcom,mdss-dsi-ce-off-command-state = "dsi_hs_mode";
		qcom,mdss-dsi-ce-on-command-state = "dsi_hs_mode";
		qcom,mdss-dsi-cabc-off-command-state = "dsi_hs_mode";
		qcom,mdss-dsi-cabc-ui-command-state = "dsi_hs_mode";
		qcom,mdss-dsi-cabc-still-command-state = "dsi_hs_mode";
		qcom,mdss-dsi-cabc-moving-command-state = "dsi_hs_mode";
		qcom,mdss-dsi-h-sync-pulse = <1>;
		qcom,mdss-dsi-traffic-mode = "burst_mode";
		qcom,mdss-dsi-bllp-eof-power-mode;
		qcom,mdss-dsi-bllp-power-mode;
		qcom,mdss-dsi-lane-0-state;
		qcom,mdss-dsi-lane-1-state;
		qcom,mdss-dsi-lane-2-state;
		qcom,mdss-dsi-lane-3-state;
		qcom,mdss-dsi-panel-timings = <0x8b1e1400 0x444a1822 0x19030400>;
		qcom,mdss-dsi-t-clk-post = <0x4>;
		qcom,mdss-dsi-t-clk-pre = <0x1c>;
		qcom,mdss-dsi-bl-min-level = <1>;
		qcom,mdss-dsi-bl-max-level = <2047>;
		qcom,mdss-dsi-dma-trigger = "trigger_sw";
		qcom,mdss-dsi-mdp-trigger = "none";
		qcom,mdss-dsi-bl-pmic-control-type = "bl_ctrl_wled";
		qcom,mdss-dsi-panel-status-check-mode = "bta_check";
		qcom,esd-check-enabled;
		qcom,mdss-dsi-reset-sequence = <0x1 0x5 0x0 0x5 0x1 0x5>;
		qcom,mdss-pan-physical-width-dimension = <0x3e>;
		qcom,mdss-pan-physical-height-dimension = <0x6e>;
		qcom,mdss-dsi-lp11-init;
		qcom,mdss-dsi-init-delay-us = <0x64>;
		qcom,mdss-night-brightness = <0x9 0x1b 0x2d 0x3f>;
		qcom,panel-supply-entries = <&dsi_panel_pwr_supply>;
	};
};