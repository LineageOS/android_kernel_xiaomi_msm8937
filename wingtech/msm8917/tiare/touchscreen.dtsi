/* From stock msm8917-pmi8937-qrd-sku5_S88508.dtsi */
&soc {
	gen-vkeys {
		/* TODO: Commonize */
		compatible = "qcom,gen-vkeys";
		label = "ft5346";
		qcom,disp-maxx = <720>;
		qcom,disp-maxy = <1280>;
		qcom,panel-maxx = <720>;
		qcom,panel-maxy = <2080>;
		qcom,key-codes = <139 172 158>;
		qcom,y-offset = <0>;
	};
};
