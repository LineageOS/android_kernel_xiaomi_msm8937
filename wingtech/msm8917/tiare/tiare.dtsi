#include "pinctrl.dtsi"

#include "android.dtsi"
#include "audio.dtsi"
#include "battery_usb.dtsi"
#include "camera.dtsi"
#include "delete.dtsi"
#include "display.dtsi"
#include "pm8937.dtsi"
#include "regulator.dtsi"
#include "soc.dtsi"
