/* From stock msm8917-pmi8937-qrd-sku5_S88503.dtsi */
&soc {
	gpio-leds {
		compatible = "gpio-leds-ir";
		status = "okay";
		pinctrl-names = "default";
		pinctrl-0 = <&gpio_led_off>;

		infred {
			gpios = <&tlmm 45 0>;
			label = "infrared";
			linux,default-trigger = "infra-red";
			default-state = "off";
			retain-state-suspended;
		};
	};
};
