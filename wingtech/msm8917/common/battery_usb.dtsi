/* From stock msm8917.dtsi */
&usb_otg {
	qcom,hsusb-otg-default-mode = <1>; /* peripheral mode */
};

/* From stock msm8917-pmi8937-qrd-sku5_S8850?.dtsi */
&i2c_5 {
	status = "ok";
};
&usb_otg {
	qcom,hsusb-otg-mode = <3>;
	interrupts = <0 134 0>,<0 140 0>,<0 136 0>;
	interrupt-names = "core_irq", "async_irq", "phy_irq";
};
/ {
	qrd_batterydata: qcom,battery-data {
		qcom,batt-id-range-pct = <15>;
		qcom,rpull-up-kohm = <68>;
		qcom,vref-batt-therm = <1800000>;
	};
};
