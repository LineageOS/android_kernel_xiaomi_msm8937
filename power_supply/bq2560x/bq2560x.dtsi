		bq2560x_otg_supply:bq2560x@6B {
			compatible = "ti,bq25601-charger";
			reg = <0x6B>;
			interrupt-parent = <&tlmm>;
			interrupts = <61 2>;
			pinctrl-names = "default";
			pinctrl-0 = <&bq2560x_int_default>;

			regulator-name = "bq2560x_otg_vreg";
			    

			ti,bq2560x,chip-enable-gpio = <48>;
			ti,bq2560x,usb-vlim = <4600>;
			ti,bq2560x,usb-ilim = <500>;
			ti,bq2560x,usb-vreg = <4400>;
			ti,bq2560x,usb-ichg = <500>;

			ti,bq2560x,ta-vlim = <4600>;
			ti,bq2560x,ta-ilim = <2000>;
			ti,bq2560x,ta-vreg = <4400>;
			ti,bq2560x,ta-ichg = <2000>;

			ti,bq2560x,precharge-current = <256>;
			ti,bq2560x,termination-current = <60>;
			ti,bq2560x,boost-voltage = <4998>;
			ti,bq2560x,boost-current = <1200>;
			ti,bq2560x,enable_term;
			ti,bq2560x,stat-pin-ctrl = <3>;
			ti,bq2560x,vac-ovp-threshold = <6500>;

			ti,bq2560x,jeita-hot-degc = <540>;
			ti,bq2560x,jeita-warm-degc = <450>;
			ti,bq2560x,jeita-cool-degc = <150>;
			ti,bq2560x,jeita-cold-degc = <0>;

			ti,bq2560x,jeita-hot-hysteresis = <10>;
			ti,bq2560x,jeita-cold-hysteresis = <0>;

			ti,bq2560x,jeita-cool-ma = <900>;
			ti,bq2560x,jeita-cool-mv = <4400>;
			ti,bq2560x,jeita-warm-ma = <900>;
			ti,bq2560x,jeita-warm-mv = <4112>;

			ti,bq2560x,software-jeita-supported;

			ti,thermal-mitigation = <1000 800 600 0>;
		};


