/* From stock msm8937-mtp.dtsi */
&soc {
	fpc1020 {
		status = "ok";
#ifdef CONFIG_FINGERPRINT_FPC1020_UGG
		compatible = "fpc,fpc1020-ugg";
#else
		compatible = "fpc,fpc1020";
#endif
		interrupt-parent = <&tlmm>;
		interrupts = <124 0x0>;
		fpc,gpio_rst    = <&tlmm 132 0x0>;
		fpc,gpio_irq    = <&tlmm 124 0x0>;
		vcc_spi-supply  = <&pm8937_l6>;
		vdd_io-supply   = <&pm8937_l6>;
		vdd_ana-supply  = <&pm8937_l6>;

		pinctrl-names = "fpc1020_reset_reset",
			"fpc1020_reset_active",
			"fpc1020_irq_active";

		pinctrl-0 = <&msm_gpio_132>;
		pinctrl-1 = <&msm_gpio_132_output_high>;
		pinctrl-2 = <&msm_gpio_124>;
	};
	goodix_fp {
#ifdef CONFIG_FINGERPRINT_GF3208_UGG
		compatible = "goodix,fingerprint-ugg";
#else
		compatible = "goodix,fingerprint";
#endif
		interrupt-parent = <&tlmm>;
		interrupt = <124 0x0>;
		vcc_spi_supply = <&pm8937_l6>;
		vcc_ana_supply = <&pm8937_l6>;
		vdd_io-supply = <&pm8937_l6>;
		goodix,gpio_reset = <&tlmm 132 0>;
		goodix,gpio_irq = <&tlmm 124 0>;
		goodix,gpio_ldo = <&tlmm 128 0>;
	};
};
