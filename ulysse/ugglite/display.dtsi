/* TODO: Remove this, is unnecessary */

/* From stock msm8917-mtp.dtsi */
&dsi_truly_720_cmd {
	/delete-property/ qcom,panel-supply-entries;
	/delete-property/ qcom,ulps-enabled;
	/delete-property/ qcom,partial-update-enabled;
	/delete-property/ qcom,panel-roi-alignment;
};
&dsi_truly_720_vid {
	/delete-property/ qcom,panel-supply-entries;
	/delete-property/ qcom,mdss-dsi-pan-enable-dynamic-fps;
	/delete-property/ qcom,mdss-dsi-pan-fps-update;
};
