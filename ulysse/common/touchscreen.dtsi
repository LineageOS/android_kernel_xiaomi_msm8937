/* From stock msm8940-pmi8937-mtp.dts */
&i2c_3 {
	status = "ok";
	clock-frequency = <400000>;
	focaltech@38 {
		compatible = "focaltech,fts";
		reg = <0x38>;
		interrupt-parent = <&tlmm>;
		interrupts = <65 IRQ_TYPE_LEVEL_LOW>;
		vdd-supply = <&pm8937_l10>;
		vcc_i2c-supply = <&pm8937_l6>;
		pinctrl-names = "pmx_ts_active","pmx_ts_suspend","pmx_ts_release";
		pinctrl-0 = <&ts_int_active &ts_reset_active>;
		pinctrl-1 = <&ts_int_suspend &ts_reset_suspend>;
		pinctrl-2 = <&ts_release>;
		focaltech,name = "fts_ts";
		focaltech,reset-gpio = <&tlmm 64 0x00>;
		focaltech,irq-gpio = <&tlmm 65 0x02>;
		focaltech,display-coords = <0 0 720 1280>;
		focaltech,max-touch-number = <10>;
		focaltech,have-key;
		focaltech,key-number = <3>;
		focaltech,keys = <139 172 158>;
		focaltech,key-y-coord = <1350>;
		focaltech,key-x-coords = <180 350 540>;
	};
	goodix@5d {
		compatible = "goodix,gt9xx";
		reg = <0x5d>;
		interrupt-parent = <&tlmm>;
		interrupts = <65 0x2>;
		vdd_ana-supply = <&pm8937_l10>;
		vcc_i2c-supply = <&pm8937_l6>;
		pinctrl-names = "pmx_ts_active","pmx_ts_suspend",
				"pmx_ts_release";
		pinctrl-0 = <&ts_int_active &ts_reset_active &ts_pwr_active>;
				pinctrl-1 = <&ts_int_suspend &ts_reset_suspend &ts_pwr_suspend>;
		pinctrl-2 = <&ts_release>;
		goodix,family-id = <0x09>;
		goodix,product-id = "9111";
		goodix,reset-gpio = <&tlmm 64 0x00>;
		goodix,power_ldo-gpio = <&tlmm 47 0x00>;
		goodix,irq-gpio = <&tlmm 65 0x00>;
		goodix,display-coords = <0 1200 0 1920>;
		goodix,panel-coords = <0 1200 0 1920>;
		goodix,i2c-pull-up;
		goodix,dbl_clk_wakeup;
		goodix,cfg-group0 = [
			52 D0 02 00 05 0A 3C CF 11 CF 32
			0F 5A 46 05 64 00 00 00 00 24 33
			00 14 16 28 14 87 27 CD 40 42 B8
			08 0F 0A 00 5A 33 91 00 00 00 00
			00 C4 C4 32 C8 00 31 1E 50 82 E0
			E4 0F 28 19 04 E2 21 00 97 28 00
			89 2E 00 80 3B 00 70 48 00 6E 10
			38 68 00 57 55 40 66 6F 17 3C 02
			02 00 00 00 00 00 00 02 00 00 0F
			28 00 00 00 00 00 0A 5A 00 00 00
			00 46 00 07 08 09 0A 0B 0C 0D 0E
			0F 10 11 18 17 16 15 14 13 06 05
			04 03 02 01 12 FF FF FF FF FF 29
			28 24 22 20 1F 1E 0A 08 06 05 04
			02 00 FF FF FF 00 00 00 00 00 00
			00 00 00 32 41 41 00 23 28 86 00
			00 00 00 00 00 00 0F 46 00 00 00
			00 00 00 28 4B 00 00 00 00 00 00
			00 01 01 14 78 1D 23 1E 3E 1E 01
			01 14 50 00 05 00 00 00 00 00 00
			00 00 00 00 00 00 EC 01
		];
	};
};
