/* From stock msm8917-mtp.dtsi */
&soc {
	/delete-node/ hbtp;
	gpio_keys {
		/delete-node/ camera_snapshot;
	};
};

/* From stock msm8937-mtp.dtsi */
&soc {
	ant_check {
		compatible = "ant_check";
		ant_check_gpio = <&tlmm 46 0x0>;
	};

	gpio_keys {
		/delete-node/ camera_focus;
	};
};

/* From stock msm8937.dtsi */
&i2c_2 {
	/delete-node/ pericom-type-c@1d;
};
