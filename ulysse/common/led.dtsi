/* From stock msm8940-pmi8937-mtp.dts */
&i2c_5 {
	awinic@45 {
		compatible = "awinic,aw2013";
		reg = <0x45>;
		vdd-supply = <&pm8937_l10>;
		vcc-supply = <&pm8937_l5>;

		aw2013,white {
			aw2013,name = "white";
			aw2013,id = <0>;
			aw2013,max-brightness = <255>;
			aw2013,max-current = <1>;
			aw2013,rise-time-ms = <2>;
			aw2013,hold-time-ms = <1>;
			aw2013,fall-time-ms = <2>;
			aw2013,off-time-ms = <1>;
		};
	};
};
