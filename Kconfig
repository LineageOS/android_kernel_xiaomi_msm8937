## Kconfig
```kconfig
menu "Xiaomi SDM439 platform"
	depends on ARCH_SDM439

config MACH_XIAOMI_SDM439
	bool "Support for Xiaomi SDM439 platform"
	help
	  Say Y here to enable support for Xiaomi SDM439 platform.

if MACH_XIAOMI_SDM439

source "techpack/xiaomi-sdm439/mach/Kconfig"

endif # MACH_XIAOMI_SDM439

endmenu
```

## backlight/Kconfig
```kconfig
menu "Backlight"
	depends on BACKLIGHT_CLASS_DEVICE

source "techpack/xiaomi-sdm439/backlight/ktd3136/Kconfig"
source "techpack/xiaomi-sdm439/backlight/lm3697/Kconfig"

endmenu
```

## drivers/clk/msm/Kconfig
```kconfig
choice
	prompt "Clock framework to use"
	depends on (ARCH_MSM8937 || ARCH_MSM8953)
	default USE_COMMON_CLK_QCOM

config USE_COMMON_CLK_QCOM
	bool "Use QCOM clk framework"
	select COMMON_CLK
	select COMMON_CLK_QCOM
	select QCOM_GDSC if ARCH_MSM8953

config USE_COMMON_CLK_MSM
	bool "Use MSM clk framework"
	select CLKDEV_LOOKUP
	select HAVE_CLK
	select HAVE_CLK_PREPARE
	select COMMON_CLK_MSM

endchoice

config COMMON_CLK_MSM
	tristate "Support for MSM clock controllers"
	depends on !COMMON_CLK
	depends on OF
	depends on ARCH_QCOM
	select RATIONAL
	help
	  This support clock controller used by MSM devices which support
	  global, mmss and gpu clock controller.
	  Say Y if you want to support the clocks exposed by the MSM on
	  platforms such as msm8953 etc.

config MSM_CLK_CONTROLLER_V2
	bool "QTI clock driver"
	depends on COMMON_CLK_MSM
	---help---
	   Generate clock data structures from definitions found in
	   device tree.

source "drivers/clk/msm/mdss/Kconfig"
```

## drivers/input/fingerprint/Kconfig
```kconfig
menu "Fingerprint Drivers"

source "drivers/input/fingerprint/fpc_ugg/Kconfig"
source "drivers/input/fingerprint/gf3208_ugg/Kconfig"

source "drivers/input/fingerprint/fpc_landtoni/Kconfig"
source "drivers/input/fingerprint/goodix_landtoni/Kconfig"

endmenu
```

## drivers/input/fingerprint/fpc_landtoni/Kconfig
```kconfig
config FINGERPRINT_FPC1020_LANDTONI
	bool "FingerPrint Cards fingerprint drvier support"
	help
	  Say Y here to enable goodix fingerprint driver support!
```

## drivers/input/fingerprint/gf3208_ugg/Kconfig
```kconfig
config FINGERPRINT_GF3208_UGG
	tristate "goodix fingerprint gf3208"
	help
	    say y enable  gf3208 goodix
```

## drivers/input/fingerprint/goodix_landtoni/Kconfig
```kconfig
config FINGERPRINT_GOODIX_GF3208_LANDTONI
	bool "Goodix GF3208 fingerprint drvier support"
	help
	  Say Y here to enable goodix fingerprint driver support!
```

## drivers/input/touchscreen/FT5346/Kconfig
```kconfig
config TOUCHSCREEN_FT5346
	tristate "FOCALTECH FT5346 touchpanel driver"
	depends on INPUT_TOUCHSCREEN
	default n
```

## drivers/input/touchscreen/ft5336/Kconfig
```kconfig
config TOUCHSCREEN_FT5336
	tristate "FOCALTECH FT5336 touchpanel driver"
	depends on INPUT_TOUCHSCREEN
	default n
```

## drivers/platform/xiaomi/Kconfig
```kconfig
menuconfig MACH_XIAOMI
	bool "Xiaomi devices"

if MACH_XIAOMI

config MACH_XIAOMI_LAND
	bool "Xiaomi Redmi 3S"
	depends on ARCH_MSM8937
	help
	  Support for Xiaomi Redmi 3S.

config MACH_XIAOMI_ROVA
	bool "Xiaomi Redmi 4A / 5A (Unified)"
	depends on ARCH_MSM8917
	help
	  Support for Xiaomi Redmi 4A / 5A (Unified).

config MACH_XIAOMI_RIVA_OREO
	bool "Enable support for Xiaomi Redmi 5A with Oreo bootloader"
	depends on MACH_XIAOMI_ROVA
	help
	  WARNING: This removes support for Xiaomi Redmi 4A.

config MACH_XIAOMI_SANTONI
	bool "Xiaomi Redmi 4X"
	depends on ARCH_MSM8940
	help
	  Support for Xiaomi Redmi 4X.

config MACH_XIAOMI_TIARE
	bool "Xiaomi Redmi Go"
	depends on ARCH_MSM8917
	depends on !MACH_XIAOMI_ROVA
	help
	  Support for Xiaomi Redmi Go.

config MACH_XIAOMI_ULYSSE
	bool "Xiaomi Redmi Note 5A (Unified)"
	depends on ARCH_MSM8917
	depends on ARCH_MSM8940
	help
	  Support for Xiaomi Redmi Note 5A (Unified).

endif
```

## fingerprint/Kconfig
```kconfig
menu "Fingerprint"

source "techpack/xiaomi-msm8937/fingerprint/fpc_ugg/Kconfig"
source "techpack/xiaomi-msm8937/fingerprint/gf3208_ugg/Kconfig"

source "techpack/xiaomi-msm8937/fingerprint/fpc_santoni/Kconfig"
source "techpack/xiaomi-msm8937/fingerprint/goodix_santoni/Kconfig"

endmenu
```

## fingerprint/fpc_ugg/Kconfig
```kconfig
config FINGERPRINT_FPC1020_UGG
    tristate "fpc fingerprint (UGG)"
    help
        say y enable fpc
```

## fingerprint/goodix_santoni/Kconfig
```kconfig
config FINGERPRINT_GOODIX_GF3208_SANTONI
	tristate "Goodix GF3208 fingerprint drvier support (santoni)"
	depends on FINGERPRINT
	help
	  Say Y here to enable goodix fingerprint driver support!
```

## power_supply/Kconfig
```kconfig
menu "Power supply"
	depends on POWER_SUPPLY

config MSM_USB_POWER_SUPPLY_MI8937
	bool "MSM USB Power supply driver"
	help
	  Say Y here to enable MSM USB Power supply driver, It
	  implements the old style USB power supply for MSM USB

endmenu
```

## power_supply/cw2015_rolex/Kconfig
```kconfig
config BATTERY_CW2015
	tristate "CW2015 battery driver"
	depends on I2C
	help
	  Say Y here to enable Test sysfs Interface for CW2015 Drivers.
```

## power_supply/cw2017_tiare/Kconfig
```kconfig
config GAUGE_CW2017
	tristate "CW2017 Battery Fg"
	depends on I2C
	help
	  Say Y to include support for CW2017 Battery FG.
```

## power_supply/qcom/Kconfig
```kconfig
config QPNP_FG_MI8937
	tristate "QPNP fuel gauge driver"
	depends on MFD_SPMI_PMIC
	help
	  Say Y here to enable the Fuel Gauge driver. This adds support for
	  battery fuel gauging and state of charge of battery connected to the
	  fuel gauge. The state of charge is reported through a BMS power
	  supply property and also sends uevents when the capacity is updated.

config QPNP_SMBCHARGER_MI8937
	tristate "QPNP SMB Charger driver"
	depends on MFD_SPMI_PMIC
	help
	  Say Y here to enable the dual path switch mode battery charger which
	  supports USB detection and battery charging up to 3A.
	  The driver also offers relevant information to userspace via the
	  power supply framework.
```

## power_supply/smb358_rolex/Kconfig
```kconfig
config SMB358_CHARGER_ROLEX
	tristate "SMB358 Battery Charger"
	depends on I2C
	help
	  Say Y to include support for SMB358 Battery Charger.
	  SMB358 is a single path switching mode charger capable of charging
	  the battery with 2Amps of current.
	  The driver supports charger enable/disable.
	  The driver reports the charger status via the power supply framework.
	  A charger status change triggers an IRQ via the device STAT pin.
```

## techpack/Kconfig
```kconfig
menu "Tech packages"

source "techpack/data/Kconfig"

source "techpack/camera-legacy/Kconfig"
source "techpack/camera-legacy-m/Kconfig"
source "techpack/xiaomi-msm8937/Kconfig"

endmenu
```

## techpack/camera-legacy-m/Kconfig
```kconfig
menu "Camera (Legacy Marshmallow)"

config MSMB_CAMERA_LEGACY_M
	bool "Qualcomm MSM camera and video capture 2.0 support (Legacy Marshmallow)"
	select MSMB_CAMERA
	help
	---help---
	  Say Y here to enable selecting the video adapters for
	  Qualcomm msm camera and video capture 2.0, enabling this
	  adds support for the camera driver stack including sensor, isp
	  and postprocessing drivers. (Legacy Marshmallow)

endmenu
```

## techpack/camera-legacy/Kconfig
```kconfig
menu "Camera (Legacy)"

config MSMB_CAMERA_LEGACY
	bool "Qualcomm MSM camera and video capture 2.0 support (Legacy)"
	select MSMB_CAMERA
	help
	---help---
	  Say Y here to enable selecting the video adapters for
	  Qualcomm msm camera and video capture 2.0, enabling this
	  adds support for the camera driver stack including sensor, isp
	  and postprocessing drivers. (Legacy)

endmenu
```

## techpack/xiaomi-msm8937/Kconfig
```kconfig
menu "Xiaomi MSM8937 platform"
	depends on ARCH_MSM8937

config MACH_XIAOMI_MSM8937
	bool "Support for Xiaomi MSM8937 platform"
	help
	  Say Y here to enable support for Xiaomi MSM8937 platform.

if MACH_XIAOMI_MSM8937

source "techpack/xiaomi-msm8937/mach/Kconfig"
source "techpack/xiaomi-msm8937/audio_pa/Kconfig"
source "techpack/xiaomi-msm8937/fingerprint/Kconfig"
source "techpack/xiaomi-msm8937/ir/Kconfig"
source "techpack/xiaomi-msm8937/leds/Kconfig"
source "techpack/xiaomi-msm8937/power_supply/Kconfig"
source "techpack/xiaomi-msm8937/regulator/Kconfig"
source "techpack/xiaomi-msm8937/touchscreen/Kconfig"
source "techpack/xiaomi-msm8937/vibrator/Kconfig"

endif # MACH_XIAOMI_MSM8937

endmenu
```
