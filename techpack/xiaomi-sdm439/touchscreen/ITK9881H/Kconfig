## techpack/xiaomi-sdm439/touchscreen/ITK9881H/Kconfig
```kconfig
config TOUCHSCREEN_ITK9881H_MI439
	bool "ITK9881H Touchscreen"
	default n
	help
	  Say Y here if you have ITK9881H Touchscreen.

	  If unsure, say N.
```

## techpack/xiaomi-sdm439/touchscreen/Kconfig
```kconfig
menu "Touchscreen"
	depends on INPUT_TOUCHSCREEN

config TOUCHSCREEN_SYSCTL_MI439
	bool "Sysctl control interface for Xiaomi SDM439 touchscreens"
	help
	  Say Y here to enable sysctl control interface for Xiaomi SDM439 touchscreens

source "techpack/xiaomi-sdm439/touchscreen/ft5446/Kconfig"
source "techpack/xiaomi-sdm439/touchscreen/FT8006S/Kconfig"
source "techpack/xiaomi-sdm439/touchscreen/gt1511q/Kconfig"
source "techpack/xiaomi-sdm439/touchscreen/ITK9881H/Kconfig"
source "techpack/xiaomi-sdm439/touchscreen/NT36525B/Kconfig"

endmenu
```

## techpack/xiaomi-sdm439/touchscreen/gt1511q/Kconfig
```kconfig
#
# Touchscreen driver configuration
#
menuconfig TOUCHSCREEN_GOODIX_GT1X_MI439
	bool "GOODIX GT1X Touchscreen"
	default y
	help
	  Say Y here if you have GOODIX GT1X Touchscreen.

	  If unsure, say N.

if TOUCHSCREEN_GOODIX_GT1X_MI439
config GTP_INT_SEL_SYNC_MI439
	bool "GTP INT GPIO SELECT I2C-ADDR AND SYNC"
	default y
	help
	  Say Y here if your want int gpio select i2c-addr

	  If unsure, say N

config GTP_INCELL_PANEL_MI439
	bool "GTP_INCELL_PANEL_MI439"
	default n
	help
	Say Y here if you have GT1152 incell panel..

	If unsure, say N.

config GTP_DRIVER_SEND_CFG_MI439
	bool "GTP_DRIVER_SEND_CONFIG"
	default y
	help
	Say Y here if you want touch driver send chip config
	data to hardware.

	If unsure, say N.

config GTP_CUSTOM_CFG_MI439
	bool "GTP_CUSTOM_CONFIG"
	default y
	help
	Say Y here if you want to customize the resolution and
	INT trigger type.

	If unsure, say N.

config GTP_CHANGE_X2Y_MI439
	bool "GTP_CHANGE_X2Y_MI439"
	default n
	help
	Say Y here if you want to change x/y coordinate.

	If unsure, say N.

config GTP_WARP_X_ON_MI439
	bool "GTP_WARP_X_ON_MI439"
	default n
	help
	Say Y here if you want to mirror x.

	If unsure, say N.

config GTP_WARP_Y_ON_MI439
	bool "GTP_WARP_Y_ON_MI439"
	default n
	help
	Say Y here if you want to mirror y.

	If unsure, say N.

config GTP_GESTURE_WAKEUP_MI439
	bool "GTP_GESTURE_WAKEUP_MI439 Feature"
	default y
	help
	Say Y here if you want to enable gesture feature.

	If unsure, say N.

config GTP_EDGE_INHIBITION_MI439
	bool "GTP_EDGE_INHIBITION_MI439 Feature"
	default n
	help
	Say Y here if you want to send cmd change edge Inhibition feature.

	If unsure, say N.

config GTP_HOTKNOT_MI439
	bool "GTP_HOTKNOT_MI439 Feature"
	default n
	help
	Say Y here if you want to enable hotknot feature.

	If unsure, say N.

config HOTKNOT_BLOCK_RW_MI439
	bool "HOTKNOT_BLOCK_RW_MI439"
	default n
	help
	Say Y here if you have want to enable blocking rw
	feature when using hotknot.

	If unsure, say N.

config GTP_FW_UPDATE_VERIFY_MI439
	bool "GTP_FW_UPDATE_VERIFY_MI439"
	default n
	help
	Say Y here if you want verify firmware in chip flash
	during firmware update, it's unnecessary to enable
	verification if you use the latest firmwrae.

	If unsure, say N.

config GTP_HAVE_TOUCH_KEY_MI439
	bool "GTP_HAVE_TOUCH_KEY_MI439"
	default n
	help
	Say Y here if you have touch key.

	If unsure, say N.

config GTP_PROXIMITY_MI439
	bool "GTP_PROXIMITY_MI439 Feature"
	default n
	help
	Say Y here if you want enable proximity feature.

	If unsure, say N.

config GTP_WITH_STYLUS_MI439
	bool "GTP_WITH_STYLUS_MI439"
	default n
	help
	Say Y here if you have pen.

	If unsure, say N.

config GTP_HAVE_STYLUS_KEY_MI439
	bool "GTP_HAVE_STYLUS_KEY_MI439"
	default n
	help
	Say Y here if you have GTP_HAVE_STYLUS_KEY_MI439.

	If unsure, say N.

config GTP_AUTO_UPDATE_MI439
	bool "GTP_AUTO_UPDATE_MI439"
	default y
	help
	Say Y here if you want to check and update firmware
	during kernel booting.

	If unsure, say N.

config GTP_ITO_TEST_SELF_MI439
	bool "GTP_ITO_TEST_SELF_MI439"
	default y
	help
	Say Y here if you want to test TP ITO
	during kernel booting.

	If unsure, say N.

config GTP_CREATE_WR_NODE_MI439
	bool "GTP_CREATE_WR_NODE_MI439 DebugTools Node"
	default y
	help
	Say Y here if you want to use Goodix debug tools..

	If unsure, say N.

config GTP_ESD_PROTECT_MI439
	bool "GTP_ESD_PROTECT_MI439"
	default n
	help
	Say Y here if you want ESD protection.

	If unsure, say N.

config GTP_CHARGER_SWITCH_MI439
	bool "GTP_CHARGER_SWITCH_MI439"
	default n
	help
	Say Y here if you want ot turn on charger detector.

	If unsure, say N.

config GTP_POWER_CTRL_SLEEP_MI439
	bool "GTP_POWER_CTRL_SLEEP_MI439"
	default n
	help
	Say Y here if you want ot power off touch panel
	after suspend.

	If unsure, say N.

config GTP_TYPE_B_PROTOCOL_MI439
	bool "GTP_TYPE_B_PROTOCOL_MI439"
	default y
	help
	Say Y here if you want to use input type B protocol.

	If unsure, say N.

config GTP_SMART_COVER_MI439
	bool "GTP_SMART_COVER_MI439"
	default n
	help
	Say Y here if you want to use smart cover feature.

	If unsure, say N.

config GTP_DEBUG_ON_MI439
	bool "GTP_DEBUG_ON_MI439"
	default n
	help
	Say Y here if you want to keep debug logs.

	If unsure, say N.

config GTP_DEBUG_ARRAY_ON_MI439
	bool "GTP_DEBUG_ARRAY_ON_MI439"
	depends on GTP_DEBUG_ON_MI439
	default n
	help
	Say Y here if you have GTP_DEBUG_ARRAY_ON_MI439.

	If unsure, say N.

config GTP_DEBUG_FUNC_ON_MI439
	bool "GTP_DEBUG_FUNC_ON_MI439"
	depends on GTP_DEBUG_ON_MI439
	default n
	help
	Say Y here if you have GTP_DEBUG_FUNC_ON_MI439.

	If unsure, say N.

config TPD_HAVE_BUTTON_MI439
	bool "TPD_HAVE_BUTTON_MI439"
	depends on MTK_PLATFORM
	default n
	help
	Say Y here if you have tpd button.

	If unsure, say N.

config GTP_REQUEST_FW_UPDATE_MI439
	bool "GTP_REQUEST_FW_UPDATE_MI439"
	default y
	help
	Say Y here if you have touch panel GTP_REQUEST_FW_UPDATE_MI439.

	If unsure, say N.

	To compile this dirver as a module, choose M here: the
	module will be called.

endif
```

## touchscreen/Atmel308U/Kconfig
```kconfig
config TOUCHSCREEN_ATMEL308U_MI8937
	tristate "ATMEL A308U touchpanel driver"
	depends on INPUT_TOUCHSCREEN
	default n
```

## touchscreen/IST30xx/Kconfig
```kconfig
config TOUCHSCREEN_IST30XX
	tristate "IMAGES IST30XX touchpanel driver"
	depends on INPUT_TOUCHSCREEN
	default n
```

## touchscreen/ITK9881H/Kconfig
```kconfig
config TOUCHSCREEN_ITK9881H
	bool "ITK9881H Touchscreen"
	default n
	help
	  Say Y here if you have ITK9881H Touchscreen.

	  If unsure, say N.
```

## touchscreen/Kconfig
```kconfig
menu "Touchscreen"
	depends on INPUT_TOUCHSCREEN

source "techpack/xiaomi-sdm439/touchscreen/ft5446/Kconfig"
source "techpack/xiaomi-sdm439/touchscreen/FT8006S/Kconfig"
source "techpack/xiaomi-sdm439/touchscreen/gt1511q/Kconfig"
source "techpack/xiaomi-sdm439/touchscreen/ITK9881H/Kconfig"
source "techpack/xiaomi-sdm439/touchscreen/NT36525B/Kconfig"

endmenu
```

## touchscreen/ft5446/Kconfig
```kconfig
#
# Focaltech Touchscreen driver configuration
#

menuconfig TOUCHSCREEN_FT5446_MI439
		bool "Focaltech Touchscreen"
		depends on I2C
		default n
		help
		  Say Y here if you have Focaltech touch panel.
		  If unsure, say N.
```

## vibrator/Kconfig
```kconfig
menu "Vibrator"

config LEDS_VIBRATOR_GPIO
	tristate "Vibrator GPIO driver"
	depends on LEDS_CLASS && GPIOLIB
	depends on OF
	help
	 This option enables support for GPIO based vibrator.

endmenu
```
