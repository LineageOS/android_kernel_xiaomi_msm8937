## techpack/xiaomi-msm8937/fingerprint/fpc_santoni/Kconfig
```kconfig
config FINGERPRINT_FPC1020_SANTONI
	tristate "FingerPrint Cards fingerprint drvier support (santoni)"
	help
	  Say Y here to enable goodix fingerprint driver support!
```

## techpack/xiaomi-msm8937/fingerprint/gf3208_ugg/Kconfig
```kconfig
config FINGERPRINT_GF3208_UGG
	tristate "goodix fingerprint gf3208 (ugg)"
	help
	    say y enable  gf3208 goodix
```

## techpack/xiaomi-msm8937/fingerprint/goodix_santoni/Kconfig
```kconfig
config FINGERPRINT_GOODIX_GF3208_SANTONI
	tristate "Goodix GF3208 fingerprint drvier support (santoni)"
	help
	  Say Y here to enable goodix fingerprint driver support!
```

## techpack/xiaomi-msm8937/ir/Kconfig
```kconfig
menu "IR"

config LEDS_GPIO_IR_MI8937
	tristate "IR LED Support for GPIO connected LEDs"
	depends on LEDS_CLASS
	depends on GPIOLIB || COMPILE_TEST
	help
	  This option enables support for the LEDs connected to GPIO
	  outputs. To be useful the particular board must have LEDs
	  and they must be connected to the GPIO lines.  The LEDs must be
	  defined as platform devices and/or OpenFirmware platform devices.
	  The code to use these bindings can be selected below.

config IR_PWM_MI8937
	tristate "PWM IR remote control"
	depends on RC_CORE
	---help---
	   Say Y if you want to use PWM based IR.

	   To compile this driver as a module, choose M here: the module will
	   be called pwm-ir.

config SPI_SPIDEV_IR_MI8937
	tristate "User mode SPI IR device driver support"
	depends on SPI
	help
	  This supports user mode SPI protocol drivers.

	  Note that this application programming interface is EXPERIMENTAL
	  and hence SUBJECT TO CHANGE WITHOUT NOTICE while it stabilizes.

endmenu
```

## techpack/xiaomi-msm8937/mach/Kconfig
```kconfig
menu "Machine selection"

# Machine families
config MACH_FAMILY_XIAOMI_ULYSSE
	bool

config MACH_FAMILY_XIAOMI_WINGTECH
	bool

config MACH_FAMILY_XIAOMI_WINGTECH_MSM8917
	bool
	depends on ARCH_MSM8917
	select MACH_FAMILY_XIAOMI_WINGTECH

config MACH_FAMILY_XIAOMI_WINGTECH_MSM8937
	bool
	depends on ARCH_MSM8937
	select MACH_FAMILY_XIAOMI_WINGTECH

# Machines
config MACH_XIAOMI_LAND
	bool "Xiaomi Redmi 3S / 3X (land)"
	select MACH_FAMILY_XIAOMI_WINGTECH_MSM8937
	help
	  Support for Xiaomi Redmi 3S / 3X (land).

config MACH_XIAOMI_SANTONI
	bool "Xiaomi Redmi 4 (India) / 4X (santoni)"
	depends on ARCH_MSM8940
	select MACH_FAMILY_XIAOMI_WINGTECH_MSM8937
	help
	  Support for Xiaomi Redmi 4 (India) / 4X (santoni).

config MACH_XIAOMI_PRADA
	bool "Xiaomi Redmi 4 (prada)"
	help
	  Support for Xiaomi Redmi 4 (prada).

config MACH_XIAOMI_ROLEX
	bool "Xiaomi Redmi 4A (rolex)"
	select MACH_FAMILY_XIAOMI_WINGTECH_MSM8917
	help
	  Support for Xiaomi Redmi 4A (rolex).

config MACH_XIAOMI_RIVA
	bool "Xiaomi Redmi 5A (riva)"
	select MACH_FAMILY_XIAOMI_WINGTECH_MSM8917
	help
	  Support for Xiaomi Redmi 5A (riva).

config MACH_XIAOMI_RIVA_OREO
	bool "Xiaomi Redmi 5A (riva) with Oreo bootloader"
	default y
	depends on MACH_XIAOMI_RIVA
	depends on !MACH_XIAOMI_ROLEX
	depends on !MACH_XIAOMI_TIARE
	help
	  Support for Xiaomi Redmi 5A (riva) with Oreo bootloader.

config MACH_XIAOMI_TIARE
	bool "Xiaomi Redmi Go (tiare)"
	depends on !MACH_XIAOMI_ROLEX
	select MACH_FAMILY_XIAOMI_WINGTECH_MSM8917
	help
	  Support for Xiaomi Redmi Go (tiare).

config MACH_XIAOMI_UGGLITE
	bool "Xiaomi Redmi Note 5A / Y1 Lite (ugglite)"
	depends on ARCH_MSM8917
	select MACH_FAMILY_XIAOMI_ULYSSE
	help
	  Support for Xiaomi Redmi Note 5A / Y1 Lite (ugglite).

config MACH_XIAOMI_UGG
	bool "Xiaomi Redmi Note 5A / Y1 Prime (ugg)"
	depends on ARCH_MSM8940
	select MACH_FAMILY_XIAOMI_ULYSSE
	help
	  Support for Xiaomi Redmi Note 5A / Y1 Prime (ugg).

endmenu
```

## techpack/xiaomi-msm8937/power_supply/Kconfig
```kconfig
menu "Power supply"
	depends on POWER_SUPPLY

config MSM_USB_POWER_SUPPLY_MI8937
	bool "MSM USB Power supply driver"
	help
	  Say Y here to enable MSM USB Power supply driver, It
	  implements the old style USB power supply for MSM USB

source "techpack/xiaomi-msm8937/power_supply/bq2560x/Kconfig"
source "techpack/xiaomi-msm8937/power_supply/bq27426/Kconfig"
source "techpack/xiaomi-msm8937/power_supply/cw2015_rolex/Kconfig"
source "techpack/xiaomi-msm8937/power_supply/cw2017_tiare/Kconfig"
source "techpack/xiaomi-msm8937/power_supply/qcom/Kconfig"
source "techpack/xiaomi-msm8937/power_supply/smb358_rolex/Kconfig"

endmenu
```

## techpack/xiaomi-msm8937/power_supply/bq2560x/Kconfig
```kconfig
config CHARGER_BQ2560X_MI8937
	tristate "TI BQ2560X battery charger driver"
	depends on I2C
	default y
	help
	  Say Y to enable support for TI bq2560X charger
```

## techpack/xiaomi-msm8937/power_supply/bq27426/Kconfig
```kconfig
config FUEL_GAUGE_BQ27426_MI8937
	tristate "TI bq27426 battery gauge driver"
	depends on I2C
	default y
	help
	  Say Y to enable support for TI bq27426 fuel gauge driver
```

## techpack/xiaomi-msm8937/power_supply/cw2015_rolex/Kconfig
```kconfig
config BATTERY_CW2015_ROLEX
	tristate "CW2015 battery driver"
	depends on I2C
	help
	  Say Y here to enable Test sysfs Interface for CW2015 Drivers.
```

## techpack/xiaomi-msm8937/power_supply/cw2017_tiare/Kconfig
```kconfig
config GAUGE_CW2017_TIARE
	tristate "CW2017 Battery Fg"
	depends on I2C
	help
	  Say Y to include support for CW2017 Battery FG.
```

## techpack/xiaomi-msm8937/regulator/Kconfig
```kconfig
menu "Regulator"
	depends on REGULATOR

config REGULATOR_TPS65132_MI8937
	tristate "TI TPS65132 Power regulator"
	depends on I2C
	select REGMAP_I2C
	help
	  This driver supports TPS65132 voltage regulator chips. The chip has
          a synchronous boost converter that generates a positive voltage which
	  is regulated down by an integrated LDO, providing a positive supply
          rail. It also has a negative supply rail which is generated by an
          integrated negative charge pump driven from the boost converter
          output. Both output regulators support 4V~6V voltage range and
	  can be configured separately. Each regulator can be enabled and
          disabled independently through an external pin.

endmenu
```

## techpack/xiaomi-msm8937/touchscreen/Kconfig
```kconfig
menu "Touchscreen"
	depends on INPUT_TOUCHSCREEN

config TOUCHSCREEN_SYSCTL_MI8937
	bool "Sysctl control interface for Xiaomi MSM8937 touchscreens"
	help
	  Say Y here to enable sysctl control interface for Xiaomi MSM8937 touchscreens

source "techpack/xiaomi-msm8937/touchscreen/Atmel308U/Kconfig"
source "techpack/xiaomi-msm8937/touchscreen/focaltech_touch/Kconfig"
source "techpack/xiaomi-msm8937/touchscreen/gt9xx/Kconfig"
source "techpack/xiaomi-msm8937/touchscreen/IST30xx/Kconfig"

endmenu
```

## techpack/xiaomi-msm8937/vibrator/Kconfig
```kconfig
menu "Vibrator"

config LEDS_VIBRATOR_GPIO_MI8937
	tristate "Vibrator GPIO driver"
	depends on LEDS_CLASS && GPIOLIB
	depends on OF
	help
	 This option enables support for GPIO based vibrator.

endmenu
```

## techpack/xiaomi-sdm439/Kconfig
```kconfig
menu "Xiaomi SDM439 platform"
	depends on ARCH_SDM439

config MACH_XIAOMI_SDM439
	bool "Support for Xiaomi SDM439 platform"
	help
	  Say Y here to enable support for Xiaomi SDM439 platform.

if MACH_XIAOMI_SDM439

source "techpack/xiaomi-sdm439/hqsysfs/Kconfig"
source "techpack/xiaomi-sdm439/mach/Kconfig"

source "techpack/xiaomi-sdm439/audio_pa/Kconfig"
source "techpack/xiaomi-sdm439/backlight/Kconfig"
source "techpack/xiaomi-sdm439/fingerprint/Kconfig"
source "techpack/xiaomi-sdm439/ir/Kconfig"
source "techpack/xiaomi-sdm439/touchscreen/Kconfig"

endif # MACH_XIAOMI_SDM439

endmenu
```

## techpack/xiaomi-sdm439/audio_pa/Kconfig
```kconfig
menu "Audio Power Amplifier"
	depends on SND_SOC

config SND_SOC_AW87329_MI439
	bool "AW87329"
	depends on I2C
	help
	  AW87329

config SND_SOC_AW87519_MI439
	bool "AW87519"
	depends on I2C
	help
	  AW87519

endmenu
```

## techpack/xiaomi-sdm439/backlight/Kconfig
```kconfig
menu "Backlight"
	depends on BACKLIGHT_LCD_SUPPORT

source "techpack/xiaomi-sdm439/backlight/ktd3136/Kconfig"
source "techpack/xiaomi-sdm439/backlight/lm3697/Kconfig"

endmenu
```

## techpack/xiaomi-sdm439/backlight/ktd3136/Kconfig
```kconfig
config BACKLIGHT_KTD3136_MI439
	bool "KTD3136"
	help
	  KTD3136 backlight driver from olive-q-oss
```

## techpack/xiaomi-sdm439/backlight/lm3697/Kconfig
```kconfig
config MFD_TI_LMU_MI439
	tristate "MFD TI LMU"
	help
	 Say Y here to support MFD TI LMU chip
```

## techpack/xiaomi-sdm439/fingerprint/Kconfig
```kconfig
menu "Fingerprint"

source "techpack/xiaomi-sdm439/fingerprint/fpr_FingerprintCard/Kconfig"
source "techpack/xiaomi-sdm439/fingerprint/goodix/Kconfig"

endmenu
```

## techpack/xiaomi-sdm439/fingerprint/fpr_FingerprintCard/Kconfig
```kconfig
#
# FingerprintCard fingerprint driver
#
menu "FingerprintCard fingerprint driver"
config FPR_FPC_MI439
       default n
       tristate "FPC_BTP fingerprint sensor support"
       depends on SPI_MASTER

endmenu
```

## techpack/xiaomi-sdm439/fingerprint/goodix/Kconfig
```kconfig
config FINGERPRINT_GOODIX_GF3208_MI439
	tristate "generic goodix fingerprint driver"
	help
	    Say Y here to enable goodix fingerprint driver support!
```

## techpack/xiaomi-sdm439/hqsysfs/Kconfig
```kconfig
config HQ_SYSFS_SUPPORT_MI439
  bool "Enable Huaqin Sysfs Driver"
  default n
  help
    Huaqin Sysfs information driver includes specific information about hardware info and other info for HQ tools
```

## techpack/xiaomi-sdm439/ir/Kconfig
```kconfig
menu "IR"
	depends on MEDIA_RC_SUPPORT

config IR_SPI_MI439
       tristate "SPI connected IR LED"
       depends on SPI && LIRC
       ---help---
          Say Y if you want to use an IR LED connected through SPI bus.

          To compile this driver as a module, choose M here: the module will be
          called ir-spi.

endmenu
```

## techpack/xiaomi-sdm439/mach/Kconfig
```kconfig
menu "Machine selection"

# Machine families
config MACH_FAMILY_XIAOMI_PINE
	bool

config MACH_FAMILY_XIAOMI_OLIVE
	bool

# Machines
config MACH_XIAOMI_PINE
	bool "Xiaomi Redmi 7A (pine)"
	select MACH_FAMILY_XIAOMI_PINE
	help
	  Support for Xiaomi Redmi 7A (pine).

config MACH_XIAOMI_OLIVE
	bool "Xiaomi Redmi 8 (olive)"
	select MACH_FAMILY_XIAOMI_OLIVE
	help
	  Support for Xiaomi Redmi 8 (olive).

config MACH_XIAOMI_OLIVELITE
	bool "Xiaomi Redmi 8A (olivelite)"
	select MACH_FAMILY_XIAOMI_OLIVE
	help
	  Support for Xiaomi Redmi 8A (olivelite).

config MACH_XIAOMI_OLIVEWOOD
	bool "Xiaomi Redmi 8A Dual (olivewood)"
	select MACH_FAMILY_XIAOMI_OLIVE
	help
	  Support for Xiaomi Redmi 8A Dual (olivewood).

endmenu
```

## techpack/xiaomi-sdm439/touchscreen/FT8006S/Kconfig
```kconfig
#
# Focaltech Touchscreen driver configuration
#

config TOUCHSCREEN_FT8006S_MI439
    bool "Focaltech Touchscreen"
    default n
    help
      Say Y here if you have Focaltech touch panel.
      If unsure, say N.
```
