/*
 * Copyright (c) 2015-2016, The Linux Foundation. All rights reserved.
 *
 * This program is free software; you can redistribute it and/or modify
 * it under the terms of the GNU General Public License version 2 and
 * only version 2 as published by the Free Software Foundation.
 *
 * This program is distributed in the hope that it will be useful,
 * but WITHOUT ANY WARRANTY; without even the implied warranty of
 * MERCHANTABILITY or FITNESS FOR A PARTICULAR PURPOSE.  See the
 * GNU General Public License for more details.
 */

/dts-v1/;

#include "../qcom/msm8937.dtsi"
#include "../qcom/msm-pmi8950.dtsi"
#include "../qcom/msm8937-qrd.dtsi"
#include "../qcom/msm8937-mdss-panels.dtsi"
#include "common/msm8937-common.dtsi"
#include "land/msm8937-land.dtsi"

/ {
	model = "Qualcomm Technologies, Inc. MSM8937-PMI8950 QRD SKU1";
	compatible = "qcom,msm8937-pmi8950-qrd-sku1",
		   "qcom,msm8937-qrd", "qcom,msm8937", "qcom,qrd";
	qcom,board-id= <0x1000b 1>, <0x2000b 1>;
};

/ {
	qrd_batterydata: qcom,battery-data {
		qcom,batt-id-range-pct = <15>;
		#include "land/batterydata-qrd-Desay-4v4-4000mah.dtsi"
		#include "land/batterydata-qrd-Atl-4v4-4000mah.dtsi"
		#include "land/batterydata-qrd-Coslight-4v4-4000mah.dtsi"
		#include "land/batterydata-qrd-feimaotui-4v4-4000mah.dtsi"
	};
};
