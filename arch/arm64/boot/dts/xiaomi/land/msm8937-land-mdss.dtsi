#include "dsi-panel-hx8394f-boe-720p-video.dtsi"
#include "dsi-panel-nt35521s-ebbg-720p-video.dtsi"
#include "dsi-panel-ili9881c-tianma-720p-video.dtsi"

&mdss_dsi0 {
        qcom,dsi-pref-prim-pan = <&dsi_hx8394f_boe_720_vid>;
        qcom,dsi-pref-sub-pan = <&dsi_nt35521s_ebbg_720_video>;
        qcom,dsi-pref-sub1-pan = <&dsi_ili9881c_tianma_720p_video>;

        qcom,regulator-ldo-mode;
        qcom,platform-regulator-settings = [ 00 01 01 00 20 07 00];
};

&dsi_hx8394f_boe_720_vid {
        qcom,panel-supply-entries = <&dsi_panel_pwr_supply>;
};

&dsi_nt35521s_ebbg_720_video {
        qcom,panel-supply-entries = <&dsi_panel_pwr_supply>;
};

&dsi_ili9881c_tianma_720p_video {
        qcom,panel-supply-entries = <&dsi_panel_pwr_supply>;
};

