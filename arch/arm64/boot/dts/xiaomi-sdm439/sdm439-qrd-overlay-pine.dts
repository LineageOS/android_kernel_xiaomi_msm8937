/*
 * Copyright (c) 2018, The Linux Foundation. All rights reserved.
 * Copyright (C) 2021 XiaoMi, Inc.
 *
 * This program is free software; you can redistribute it and/or modify
 * it under the terms of the GNU General Public License version 2 and
 * only version 2 as published by the Free Software Foundation.
 *
 * This program is distributed in the hope that it will be useful,
 * but WITHOUT ANY WARRANTY; without even the implied warranty of
 * MERCHANTABILITY or FITNESS FOR A PARTICULAR PURPOSE.  See the
 * GNU General Public License for more details.
 */

/dts-v1/;
/plugin/;

#define DO_NOT_INCLUDE_DEFAULT_CAMERA_SENSOR_DTSI

#include "qcom/sdm439-qrd.dtsi"

#include "dtbo/common/common.dtsi"
#include "dtbo/pine/pine.dtsi"

/ {
	model = "PINE QRD";
	qcom,board-id = <0xb 2>;
};
