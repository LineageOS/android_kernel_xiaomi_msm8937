/* From stock sdm439-camera-sensor-mtp.dtsi */
&cci {
	/delete-property/ #address-cells;
	/delete-property/ #size-cells;

	/delete-node/ qcom,actuator@0;
	/delete-node/ qcom,actuator@1;
	/delete-node/ qcom,eeprom@0;
	/delete-node/ qcom,eeprom@1;
	/delete-node/ qcom,eeprom@2;

	/delete-node/ qcom,camera@0;
	/delete-node/ qcom,camera@1;
	/delete-node/ qcom,camera@2;
};
