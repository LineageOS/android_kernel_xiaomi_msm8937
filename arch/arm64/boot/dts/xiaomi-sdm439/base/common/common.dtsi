#include "android.dtsi"
#include "audio.dtsi"
#include "camera-mtp-delete.dtsi"
#include "camera-mtp.dtsi"
#include "display.dtsi"
#include "misc.dtsi"
#include "pinctrl.dtsi"
#include "pm8953.dtsi"
#include "pmi632.dtsi"
#include "regulator.dtsi"
#include "soc.dtsi"
