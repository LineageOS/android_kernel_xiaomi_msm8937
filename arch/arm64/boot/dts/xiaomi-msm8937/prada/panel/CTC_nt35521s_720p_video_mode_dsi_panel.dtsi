&mdss_mdp {
	dsi_nt35521s_ctc_720p_video: qcom,mdss_dsi_nt35521s_ctc_720p_video {
		xiaomi,panel-id = <1>;
		qcom,mdss-dsi-panel-name = "CTC_nt35521s_720p_video_mode_dsi_panel";
		qcom,mdss-dsi-panel-controller = <&mdss_dsi0>;
		qcom,mdss-dsi-panel-type = "dsi_video_mode";
		qcom,mdss-dsi-panel-destination = "display_1";
		qcom,mdss-dsi-panel-framerate = <0x3c>;
		qcom,mdss-dsi-virtual-channel-id = <0>;
		qcom,mdss-dsi-stream = <0>;
		qcom,mdss-dsi-panel-width = <0x2d0>;
		qcom,mdss-dsi-panel-height = <0x500>;
		qcom,mdss-dsi-h-front-porch = <0x96>;
		qcom,mdss-dsi-h-back-porch = <0x92>;
		qcom,mdss-dsi-h-pulse-width = <0x14>;
		qcom,mdss-dsi-h-sync-skew = <0>;
		qcom,mdss-dsi-v-back-porch = <0x1c>;
		qcom,mdss-dsi-v-front-porch = <0x23>;
		qcom,mdss-dsi-v-pulse-width = <0x2>;
		qcom,mdss-dsi-h-left-border = <0>;
		qcom,mdss-dsi-h-right-border = <0>;
		qcom,mdss-dsi-v-top-border = <0>;
		qcom,mdss-dsi-v-bottom-border = <0>;
		qcom,mdss-dsi-bpp = <0x18>;
		qcom,mdss-dsi-underflow-color = <0xff>;
		qcom,mdss-dsi-border-color = <0>;
		qcom,mdss-dsi-on-command = [39 01 00 00 00 00 06 f0 55 aa 52 08 02 39 01 00 00 00 00 02 ee 00 39 01 00 00 00 00 06 f0 55 aa 52 08 00 39 01 00 00 00 00 02 51 ff 39 01 00 00 00 00 02 53 2c 39 01 00 00 00 00 02 55 00 39 01 00 00 00 00 06 f0 55 aa 52 08 00 39 01 00 00 00 00 02 c8 80 39 01 00 00 00 00 02 b1 64 39 01 00 00 00 00 06 f0 55 aa 52 00 00 39 01 00 00 00 00 05 ff aa 55 25 01 39 01 00 00 00 00 02 6f 10 39 01 00 00 00 00 02 f7 1d 39 01 00 00 00 00 05 ff aa 55 25 00 39 01 00 00 00 00 02 64 07 05 01 00 00 78 00 02 11 00 05 01 00 00 05 00 02 29 00];
		qcom,mdss-dsi-off-command = [05 01 00 00 05 00 02 28 00 05 01 00 00 64 00 02 10 00];
		qcom,mdss-dsi-ct-normal-command = <0x39010000 0x6f0 0x55aa5208 0x2390100 0x2 0xee003901 0x0 0x6f055aa 0x52080039 0x1000000 0x22601>;
		qcom,mdss-dsi-ct-warm-command = <0x39010000 0x6f0 0x55aa5208 0x2390100 0x2 0xee003901 0x0 0x6f055aa 0x52080039 0x1000000 0x22602>;
		qcom,mdss-dsi-ct-cold-command = <0x39010000 0x6f0 0x55aa5208 0x2390100 0x2 0xee003901 0x0 0x6f055aa 0x52080039 0x1000000 0x22604>;
		qcom,mdss-dsi-eyecare1-command = [39 00 00 00 00 00 06 f0 55 aa 52 08 02 39 01 00 00 00 00 02 ee 03 39 00 00 00 00 00 11 b0 00 14 00 2c 00 51 00 6d 00 85 00 ab 00 ca 00 fc 39 01 00 00 00 00 11 b1 01 24 01 60 01 8e 01 d7 02 10 02 12 02 47 02 89 39 00 00 00 00 00 11 b2 02 b4 02 ee 03 14 03 43 03 60 03 86 03 97 03 b0 39 01 00 00 00 00 05 b3 03 d3 03 d5 39 00 00 00 00 00 11 b4 01 02 01 06 01 0f 01 18 01 21 01 31 01 40 01 59 39 01 00 00 00 00 11 b5 01 70 01 98 01 bb 01 f3 02 24 02 26 02 59 02 98 39 00 00 00 00 00 11 b6 02 c3 02 fb 03 20 03 4e 03 6a 03 8c 03 9e 03 b4 39 01 00 00 00 00 05 b7 03 d0 03 d5 39 00 00 00 00 00 11 b8 01 51 01 54 01 59 01 5f 01 64 01 6e 01 77 01 8a 39 01 00 00 00 00 11 b9 01 9c 01 bc 01 d7 02 08 02 35 02 36 02 67 02 a5 39 00 00 00 00 00 11 ba 02 cf 03 07 03 29 03 56 03 71 03 8e 03 a2 03 cf 39 01 00 00 00 00 05 bb 03 d4 03 d5];
		qcom,mdss-dsi-eyecare2-command = [39 00 00 00 00 00 06 f0 55 aa 52 08 02 39 01 00 00 00 00 02 ee 03 39 00 00 00 00 00 11 b0 00 14 00 2c 00 51 00 6d 00 85 00 ab 00 ca 00 fc 39 01 00 00 00 00 11 b1 01 24 01 60 01 8e 01 d7 02 10 02 12 02 47 02 89 39 00 00 00 00 00 11 b2 02 b4 02 ee 03 14 03 43 03 60 03 86 03 97 03 b0 39 01 00 00 00 00 05 b3 03 d3 03 d5 39 00 00 00 00 00 11 b4 01 02 01 06 01 0f 01 18 01 21 01 31 01 40 01 59 39 01 00 00 00 00 11 b5 01 70 01 98 01 bb 01 f3 02 24 02 26 02 59 02 98 39 00 00 00 00 00 11 b6 02 c3 02 fb 03 20 03 4e 03 6a 03 8c 03 9e 03 b4 39 01 00 00 00 00 05 b7 03 d0 03 d5 39 00 00 00 00 00 11 b8 01 75 01 77 01 7b 01 80 01 84 01 8d 01 96 01 a5 39 01 00 00 00 00 11 b9 01 b4 01 cf 01 e7 02 14 02 3e 02 3f 02 70 02 ad 39 00 00 00 00 00 11 ba 02 d6 03 0e 03 30 03 5b 03 75 03 90 03 a5 03 d1 39 01 00 00 00 00 05 bb 03 d4 03 d5];
		qcom,mdss-dsi-eyecare3-command = [39 00 00 00 00 00 06 f0 55 aa 52 08 02 39 01 00 00 00 00 02 ee 03 39 00 00 00 00 00 11 b0 00 14 00 2c 00 51 00 6d 00 85 00 ab 00 ca 00 fc 39 01 00 00 00 00 11 b1 01 24 01 60 01 8e 01 d7 02 10 02 12 02 47 02 89 39 00 00 00 00 00 11 b2 02 b4 02 ee 03 14 03 43 03 60 03 86 03 97 03 b0 39 01 00 00 00 00 05 b3 03 d3 03 d5 39 00 00 00 00 00 11 b4 01 02 01 06 01 0f 01 18 01 21 01 31 01 40 01 59 39 01 00 00 00 00 11 b5 01 70 01 98 01 bb 01 f3 02 24 02 26 02 59 02 98 39 00 00 00 00 00 11 b6 02 c3 02 fb 03 20 03 4e 03 6a 03 8c 03 9e 03 b4 39 01 00 00 00 00 05 b7 03 d0 03 d5 39 00 00 00 00 00 11 b8 01 91 01 93 01 97 01 9b 01 9f 01 a6 01 ad 01 bb 39 01 00 00 00 00 11 b9 01 c8 01 e0 01 f6 02 1e 02 47 02 49 02 78 02 b5 39 00 00 00 00 00 11 ba 02 de 03 14 03 36 03 60 03 79 03 94 03 a8 03 d2 39 01 00 00 00 00 05 bb 03 d4 03 d5];
		qcom,mdss-dsi-eyecare4-command = [39 00 00 00 00 00 06 f0 55 aa 52 08 02 39 01 00 00 00 00 02 ee 03 39 00 00 00 00 00 11 b0 00 14 00 2c 00 51 00 6d 00 85 00 ab 00 ca 00 fc 39 01 00 00 00 00 11 b1 01 24 01 60 01 8e 01 d7 02 10 02 12 02 47 02 89 39 00 00 00 00 00 11 b2 02 b4 02 ee 03 14 03 43 03 60 03 86 03 97 03 b0 39 01 00 00 00 00 05 b3 03 d3 03 d5 39 00 00 00 00 00 11 b4 01 02 01 06 01 0f 01 18 01 21 01 31 01 40 01 59 39 01 00 00 00 00 11 b5 01 70 01 98 01 bb 01 f3 02 24 02 26 02 59 02 98 39 00 00 00 00 00 11 b6 02 c3 02 fb 03 20 03 4e 03 6a 03 8c 03 9e 03 b4 39 01 00 00 00 00 05 b7 03 d4 03 d5 39 00 00 00 00 00 11 b8 01 b1 01 b2 01 b6 01 b9 01 bc 01 c2 01 c8 01 d3 39 01 00 00 00 00 11 b9 01 de 01 f3 02 06 02 2c 02 53 02 54 02 83 02 be 39 00 00 00 00 00 11 ba 02 e7 03 1c 03 3d 03 67 03 80 03 99 03 aa 03 d2 39 01 00 00 00 00 05 bb 03 d4 03 d5];
		qcom,mdss-dsi-eyecare5-command = [39 00 00 00 00 00 06 f0 55 aa 52 08 02 39 01 00 00 00 00 02 ee 03 39 00 00 00 00 00 11 b0 00 14 00 2c 00 51 00 6d 00 85 00 ab 00 ca 00 fc 39 01 00 00 00 00 11 b1 01 24 01 60 01 8e 01 d7 02 10 02 12 02 47 02 89 39 00 00 00 00 00 11 b2 02 b4 02 ee 03 14 03 43 03 60 03 86 03 97 03 b0 39 01 00 00 00 00 05 b3 03 d3 03 d5 39 00 00 00 00 00 11 b4 01 02 01 06 01 0f 01 18 01 21 01 31 01 40 01 59 39 01 00 00 00 00 11 b5 01 70 01 98 01 bb 01 f3 02 24 02 26 02 59 02 98 39 00 00 00 00 00 11 b6 02 c3 02 fb 03 20 03 4e 03 6a 03 8c 03 9e 03 b4 39 01 00 00 00 00 05 b7 03 d0 03 d5 39 00 00 00 00 00 11 b8 01 c8 01 c9 01 cc 01 cf 01 d1 01 d6 01 db 01 e6 39 01 00 00 00 00 11 b9 01 ef 02 02 02 14 02 37 02 5d 02 5e 02 8b 02 c7 39 00 00 00 00 00 11 ba 02 ef 03 23 03 43 03 6c 03 85 03 9d 03 ac 03 d2 39 01 00 00 00 00 05 bb 03 d4 03 d5];
		qcom,mdss-dsi-eyecare6-command = [39 00 00 00 00 00 06 f0 55 aa 52 08 02 39 01 00 00 00 00 02 ee 03 39 00 00 00 00 00 11 b0 00 14 00 2c 00 51 00 6d 00 85 00 ab 00 ca 00 fc 39 01 00 00 00 00 11 b1 01 24 01 60 01 8e 01 d7 02 10 02 12 02 47 02 89 39 00 00 00 00 00 11 b2 02 b4 02 ee 03 14 03 43 03 60 03 86 03 97 03 b0 39 01 00 00 00 00 05 b3 03 d3 03 d5 39 00 00 00 00 00 11 b4 01 02 01 06 01 0f 01 18 01 21 01 31 01 40 01 59 39 01 00 00 00 00 11 b5 01 70 01 98 01 bb 01 f3 02 24 02 26 02 59 02 98 39 00 00 00 00 00 11 b6 02 c3 02 fb 03 20 03 4e 03 6a 03 8c 03 9e 03 b4 39 01 00 00 00 00 05 b7 03 d0 03 d5 39 00 00 00 00 00 11 b8 01 de 01 e0 01 e2 01 e5 01 e6 01 eb 01 f0 01 f8 39 01 00 00 00 00 11 b9 02 01 02 12 02 22 02 44 02 68 02 6a 02 96 02 d1 39 00 00 00 00 00 11 ba 02 f8 03 2a 03 4a 03 71 03 89 03 a1 03 c6 03 d3 39 01 00 00 00 00 05 bb 03 d4 03 d5];
		qcom,mdss-dsi-eyecare7-command = [39 00 00 00 00 00 06 f0 55 aa 52 08 02 39 01 00 00 00 00 02 ee 03 39 00 00 00 00 00 11 b0 00 14 00 2c 00 51 00 6d 00 85 00 ab 00 ca 00 fc 39 01 00 00 00 00 11 b1 01 24 01 60 01 8e 01 d7 02 10 02 12 02 47 02 89 39 00 00 00 00 00 11 b2 02 b4 02 ee 03 14 03 43 03 60 03 86 03 97 03 b0 39 01 00 00 00 00 05 b3 03 d3 03 d5 39 00 00 00 00 00 11 b4 01 02 01 06 01 0f 01 18 01 21 01 31 01 40 01 59 39 01 00 00 00 00 11 b5 01 70 01 98 01 bb 01 f3 02 24 02 26 02 59 02 98 39 00 00 00 00 00 11 b6 02 c3 02 fb 03 20 03 4e 03 6a 03 8c 03 9e 03 b4 39 01 00 00 00 00 05 b7 03 d0 03 d5 39 00 00 00 00 00 11 b8 01 f4 01 f5 01 f7 01 f9 01 fb 01 ff 02 02 02 0b 39 01 00 00 00 00 11 b9 02 12 02 21 02 31 02 50 02 75 02 76 02 a1 02 dc 39 00 00 00 00 00 11 ba 03 03 03 33 03 52 03 76 03 8c 03 a5 03 ca 03 d3 39 01 00 00 00 00 05 bb 03 d4 03 d5];
		qcom,mdss-dsi-eyecare8-command = [39 00 00 00 00 00 06 f0 55 aa 52 08 02 39 01 00 00 00 00 02 ee 03 39 00 00 00 00 00 11 b0 00 14 00 2c 00 51 00 6d 00 85 00 ab 00 ca 00 fc 39 01 00 00 00 00 11 b1 01 24 01 60 01 8e 01 d7 02 10 02 12 02 47 02 89 39 00 00 00 00 00 11 b2 02 b4 02 ee 03 14 03 43 03 60 03 86 03 97 03 b0 39 01 00 00 00 00 05 b3 03 d3 03 d5 39 00 00 00 00 00 11 b4 01 02 01 06 01 0f 01 18 01 21 01 31 01 40 01 59 39 01 00 00 00 00 11 b5 01 70 01 98 01 bb 01 f3 02 24 02 26 02 59 02 98 39 00 00 00 00 00 11 b6 02 c3 02 fb 03 20 03 4e 03 6a 03 8c 03 9e 03 b4 39 01 00 00 00 00 05 b7 03 d0 03 d5 39 00 00 00 00 00 11 b8 02 07 02 08 02 0a 02 0b 02 0e 02 11 02 14 02 1b 39 01 00 00 00 00 11 b9 02 23 02 31 02 3f 02 5e 02 81 02 82 02 ad 02 e7 39 00 00 00 00 00 11 ba 03 0d 03 3c 03 5a 03 7d 03 8e 03 a8 03 ce 03 d3 39 01 00 00 00 00 05 bb 03 d4 03 d5];
		qcom,mdss-dsi-cabc-ce-off-command = [39 01 00 00 00 00 06 f0 55 aa 52 08 02 39 01 00 00 00 00 02 ee 00 39 01 00 00 00 00 06 f0 55 aa 52 08 00 39 01 00 00 00 00 02 51 ff 39 01 00 00 00 00 02 53 2c 39 01 00 00 00 00 02 55 00];
		qcom,mdss-dsi-cabc-on-ce-off-command = [39 01 00 00 00 00 06 f0 55 aa 52 08 02 39 01 00 00 00 00 02 ee 00 39 01 00 00 00 00 06 f0 55 aa 52 08 00 39 01 00 00 00 00 02 51 ff 39 01 00 00 00 00 02 53 2c 39 01 00 00 ff 00 02 55 01];
		qcom,mdss-dsi-cabc-on-ce-on-command = [39 01 00 00 00 00 06 f0 55 aa 52 08 02 39 01 00 00 00 00 02 ee 00 39 01 00 00 00 00 06 f0 55 aa 52 08 00 39 01 00 00 00 00 02 51 ff 39 01 00 00 00 00 02 53 2c 39 01 00 00 00 00 02 55 81];
		qcom,mdss-dsi-cabc-off-ce-on-command = [39 01 00 00 00 00 06 f0 55 aa 52 08 02 39 01 00 00 00 00 02 ee 00 39 01 00 00 00 00 06 f0 55 aa 52 08 00 39 01 00 00 00 00 02 51 ff 39 01 00 00 00 00 02 53 2c 39 01 00 00 00 00 02 55 80];
		qcom,mdss-dsi-on-command-state = "dsi_lp_mode";
		qcom,mdss-dsi-off-command-state = "dsi_lp_mode";
		qcom,mdss-dsi-ct-normal-command-state = "dsi_lp_mode";
		qcom,mdss-dsi-ct-warm-command-state = "dsi_lp_mode";
		qcom,mdss-dsi-ct-cold-command-state = "dsi_lp_mode";
		qcom,mdss-dsi-eyecare1-command-state = "dsi_lp_mode";
		qcom,mdss-dsi-eyecare2-command-state = "dsi_lp_mode";
		qcom,mdss-dsi-eyecare3-command-state = "dsi_lp_mode";
		qcom,mdss-dsi-eyecare4-command-state = "dsi_lp_mode";
		qcom,mdss-dsi-eyecare5-command-state = "dsi_lp_mode";
		qcom,mdss-dsi-eyecare6-command-state = "dsi_lp_mode";
		qcom,mdss-dsi-eyecare7-command-state = "dsi_lp_mode";
		qcom,mdss-dsi-eyecare8-command-state = "dsi_lp_mode";
		qcom,mdss-dsi-cabc-ce-off-command-state = "dsi_lp_mode";
		qcom,mdss-dsi-cabc-on-ce-off-command-state = "dsi_lp_mode";
		qcom,mdss-dsi-cabc-on-ce-on-command-state = "dsi_lp_mode";
		qcom,mdss-dsi-cabc-off-ce-on-command-state = "dsi_lp_mode";
		qcom,mdss-dsi-h-sync-pulse = <1>;
		qcom,mdss-dsi-traffic-mode = "burst_mode";
		qcom,mdss-dsi-bllp-eof-power-mode;
		qcom,mdss-dsi-bllp-power-mode;
		qcom,mdss-dsi-lane-0-state;
		qcom,mdss-dsi-lane-1-state;
		qcom,mdss-dsi-lane-2-state;
		qcom,mdss-dsi-lane-3-state;
		qcom,mdss-dsi-panel-timings = <0x8c201400 0x46481a22 0x18030400>;
		qcom,mdss-dsi-t-clk-post = <0x4>;
		qcom,mdss-dsi-t-clk-pre = <0x1c>;
		qcom,mdss-dsi-bl-min-level = <1>;
		qcom,mdss-dsi-bl-max-level = <2047>;
		qcom,mdss-dsi-dma-trigger = "trigger_sw";
		qcom,mdss-dsi-mdp-trigger = "none";
		qcom,mdss-dsi-bl-pmic-control-type = "bl_ctrl_wled";
		qcom,mdss-dsi-panel-status-check-mode = "bta_check";
		qcom,esd-check-enabled;
		qcom,mdss-dsi-reset-sequence = <0x1 0x5 0x0 0x5 0x1 0x5>;
		qcom,mdss-pan-physical-width-dimension = <0x3e>;
		qcom,mdss-pan-physical-height-dimension = <0x6e>;
		qcom,mdss-dsi-lp11-init;
		qcom,mdss-dsi-init-delay-us = <0x64>;
		qcom,mdss-night-brightness = <0x9 0x1b 0x2d 0x3f>;
		qcom,panel-supply-entries = <&dsi_panel_pwr_supply>;
	};
};