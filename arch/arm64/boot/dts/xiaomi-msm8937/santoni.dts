/*
 * Copyright (c) 2016, The Linux Foundation. All rights reserved.
 * Copyright (C) 2018 XiaoMi, Inc.
 *
 * This program is free software; you can redistribute it and/or modify
 * it under the terms of the GNU General Public License version 2 and
 * only version 2 as published by the Free Software Foundation.
 *
 * This program is distributed in the hope that it will be useful,
 * but WITHOUT ANY WARRANTY; without even the implied warranty of
 * MERCHANTABILITY or FITNESS FOR A PARTICULAR PURPOSE.  See the
 * GNU General Public License for more details.
 */

/dts-v1/;

#include "common/include/config.h"

#include "qcom/msm8940.dtsi"
#include "qcom/pmi8950.dtsi"
#include "common/fragments/qcom/msm8937-qrd.dtsi"
#include "qcom/msm8937-mdss-panels.dtsi"
#include "qcom/msm8940-pinctrl.dtsi"

#include "common/fragments/delete-msm89x7-camera-sensor-qrd.dtsi"
#include "common/fragments/legacy-bcl.dtsi"
#include "common/fragments/qti-haptics.dtsi"
#include "common/fragments/restore-old-msm8937-camera-pinctrl.dtsi"

#include "common/common.dtsi"
#include "wingtech/common/common.dtsi"
#include "wingtech/msm8937/common/common.dtsi"
#include "wingtech/msm8937/santoni/santoni.dtsi"

/ {
	model = "Qualcomm Technologies, Inc. MSM8940-PMI8950 QRD SKU7";
	compatible = "qcom,msm8940-qrd-sku7", "qcom,msm8940-qrd",
			"qcom,msm8940", "qcom,qrd", "xiaomi,santoni";
	qcom,board-id= <0x1000b 1>, <0x2000b 1>;
	qcom,pmic-id = <0x10019 0x010011 0x0 0x0>;

#ifndef MI8937_V2
	xiaomi,series = "landtoni";
	xiaomi,device = "santoni";
#endif
};
