&pm8937_s2_floor_level {
	regulator-max-microvolt = <RPM_SMD_REGULATOR_LEVEL_TURBO>;
};

&pm8937_s2_level {
	regulator-max-microvolt = <RPM_SMD_REGULATOR_LEVEL_TURBO>;
};

&pm8937_s2_level_ao {
	regulator-max-microvolt = <RPM_SMD_REGULATOR_LEVEL_TURBO>;
};
