&cont_splash_mem {
	reg = <0x0 0x8dd00000 0x0 0x1400000>;
};

&soc {
	qcom,wcnss-wlan@0a000000 {
		qcom,vddcx-voltage-level = <RPM_SMD_REGULATOR_LEVEL_NOM
					RPM_SMD_REGULATOR_LEVEL_NONE
					RPM_SMD_REGULATOR_LEVEL_TURBO>;
	};
};
