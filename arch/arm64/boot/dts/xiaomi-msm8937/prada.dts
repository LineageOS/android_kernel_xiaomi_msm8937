/*
 * Copyright (c) 2015-2016, 2018, The Linux Foundation. All rights reserved.
 *
 * This program is free software; you can redistribute it and/or modify
 * it under the terms of the GNU General Public License version 2 and
 * only version 2 as published by the Free Software Foundation.
 *
 * This program is distributed in the hope that it will be useful,
 * but WITHOUT ANY WARRANTY; without even the implied warranty of
 * MERCHANTABILITY or FITNESS FOR A PARTICULAR PURPOSE.  See the
 * GNU General Public License for more details.
 */

/dts-v1/;

#include "common/include/config.h"

#include "qcom/msm8937.dtsi"
#include "qcom/msm8937-pmi8950-mtp.dtsi"

#include "common/fragments/delete-msm89x7-camera-sensor-mtp.dtsi"
#include "common/fragments/legacy-bcl.dtsi"
#include "common/fragments/qti-haptics.dtsi"
#include "common/fragments/restore-old-msm8937-camera-pinctrl.dtsi"

#include "common/common.dtsi"
#include "prada/prada.dtsi"

/ {
	model = "Qualcomm Technologies, Inc. MSM8937-PMI8950 MTP";
	compatible = "qcom,msm8937-mtp", "qcom,msm8937", "qcom,mtp", "xiaomi,prada";
	qcom,board-id= <8 0>;
	qcom,pmic-id = <0x10019 0x010011 0x0 0x0>;

#ifndef MI8937_V2
	xiaomi,series = "prada";
	xiaomi,device = "prada";
#endif
};
