/ {
	reserved-memory {
		ramoops: ramoops {
			compatible = "ramoops";
			reg = <0 0xb0000000 0 0x800000>;
			record-size = <0x200000>;
			console-size = <0x200000>;
			pmsg-size = <0x200000>;
		};
	};
};
