&i2c_3 {
	status = "ok";
	focaltech@38 {
		compatible = "focaltech,fts";
		reg = <0x38>;
		interrupt-parent = <&tlmm>;
		interrupts = <0x41 0x0>;
		vdd-supply = <&pm8937_l10>;
		vcc_i2c-supply = <&pm8937_l6>;
		pinctrl-names = "pmx_ts_active", "pmx_ts_suspend", "pmx_ts_release";
		pinctrl-0 = <&ts_int_active &ts_reset_active>;
		pinctrl-1 = <&ts_int_suspend &ts_reset_suspend>;
		pinctrl-2 = <&ts_release>;
		focaltech,name = "focaltech";
		focaltech,family-id = <0x14>;
		focaltech,reset-gpio = <&tlmm 0x40 0x0>;
		focaltech,irq-gpio = <&tlmm 0x41 0x0>;
		focaltech,display-coords = <0x0 0x0 0x2d0 0x500>;
		focaltech,panel-coords = <0x0 0x0 0x2d0 0x500>;
		focaltech,button-map = <0xb4 0x21c 0x384>;
		focaltech,no-force-update;
		focaltech,i2c-pull-up;
		focaltech,group-id = <0x1>;
		focaltech,hard-reset-delay-ms = <0x14>;
		focaltech,soft-reset-delay-ms = <0x96>;
		focaltech,num-max-touches = <0xa>;
		focaltech,fw-name = "FT_Upgrade_App.i";
		focaltech,fw-delay-aa-ms = <0x1e>;
		focaltech,fw-delay-55-ms = <0x1e>;
		focaltech,fw-upgrade-id1 = <0x79>;
		focaltech,fw-upgrade-id2 = <0x11>;
		focaltech,fw-delay-readid-ms = <0xa>;
		focaltech,fw-delay-era-flsh-ms = <0x7d0>;
		focaltech,fw-vkey-support = <0x1>;
		focaltech,fw-auto-cal;
		focaltech,psensor-support;
		focaltech,gesture-support;
	};
	
	atmel_mxt_ts@4a {
		compatible = "atmel,mxt-ts";
		reg = <0x4a>;
		interrupt-parent = <&tlmm>;
		interrupts = <0x41 0x2008>;
		vddio-supply = <&pm8937_l6>;
		vdd-supply = <&pm8937_l10>;
		pinctrl-names = "pmx_ts_active", "pmx_ts_suspend";
		pinctrl-0 = <&ts_int_active &ts_reset_active>;
		pinctrl-1 = <&ts_int_suspend &ts_reset_suspend>;
		atmel,reset-gpio = <&tlmm 0x40 0x0>;
		atmel,irq-gpio = <&tlmm 0x41 0x2008>;
		atmel,mxt-fw-name = "mxt_308u.enc";
		atmel,config-array-size = <0x1>;
		atmel,default-config = <0x0>;
		atmel,irqflags = <0x2008>;
		atmel,vendor-id-byte = [00 03];

		atmel,cfg_1 {
			atmel,family-id = <0xa6>;
			atmel,variant-id = <0x7>;
			atmel,version = <0x10>;
			atmel,build = <0xab>;
			atmel,rev-id = <0x2>;
			atmel,panel-id = <0x0>;
			atmel,mxt-cfg-name = "mxt_308u_b5_f.raw";
			atmel,vendor-id = <0x31 0x31>;
			atmel,key-codes = <0x9e 0xac 0x8b>;
			atmel,selfintthr-stylus = <0x0>;
			atmel,t71-tchthr-pos = <0x16>;
			atmel,self-chgtime-min = <0x0>;
			atmel,self-chgtime-max = <0x0>;
			atmel,mult-intthr-sensitive = <0xc>;
			atmel,mult-intthr-not-sensitive = <0x11>;
			atmel,atchthr-sensitive = <0x6>;
			atmel,mult-tchthr-sensitive = <0x0>;
			atmel,mult-tchthr-not-sensitive = <0x0>;
			atmel,wake-up-self-adcx = <0x10>;
		};
	};
};