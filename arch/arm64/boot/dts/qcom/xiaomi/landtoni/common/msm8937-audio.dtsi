&int_codec {
	qcom,msm-mbhc-hphl-swh = <1>;
	qcom,msm-hs-micbias-type = "internal";
	ext-spk-amp-gpio = <&tlmm 124 0>;
	headset-gpio = <&tlmm 129 0>;
	qcom,audio-routing =
		"RX_BIAS", "MCLK",
		"SPK_RX_BIAS", "MCLK",
		"INT_LDO_H", "MCLK",
		"MIC BIAS External", "Handset Mic",
		"MIC BIAS Internal2", "Headset Mic",
		"MIC BIAS External", "Secondary Mic",
		"AMIC1", "MIC BIAS External",
		"AMIC2", "MIC BIAS Internal2",
		"AMIC3", "MIC BIAS External",
		"WSA_SPK OUT", "VDD_WSA_SWITCH",
		"SpkrMono WSA_IN", "WSA_SPK OUT";
	/delete-property/ asoc-wsa-codec-names;
	/delete-property/ asoc-wsa-codec-prefixes;
	/delete-property/ msm-vdd-wsa-switch-supply;
	/delete-property/ qcom,msm-vdd-wsa-switch-voltage;
	/delete-property/ qcom,msm-vdd-wsa-switch-current;
	/delete-property/ qcom,msm-gpios;
	/delete-property/ qcom,pinctrl-names;
	/delete-property/ pinctrl-names;
	/delete-property/ pinctrl-0;
	/delete-property/ pinctrl-1;
};

&wsa881x_i2c_f {
	status = "disabled";
};

&wsa881x_i2c_45 {
	status = "disabled";
};

