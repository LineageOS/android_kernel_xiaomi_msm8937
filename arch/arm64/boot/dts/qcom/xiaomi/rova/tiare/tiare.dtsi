#include "import-riva.dtsi"
#include "remove-riva.dtsi"

#include "pinctrl.dtsi"

#include "android.dtsi"
#include "audio.dtsi"
#include "battery.dtsi"
#include "camera.dtsi"
#include "display.dtsi"
#include "misc.dtsi"
#include "pm.dtsi"
#include "soc.dtsi"
