/*
 * Copyright (c) 2016, The Linux Foundation. All rights reserved.
 * Copyright (C) 2018 XiaoMi, Inc.
 *
 * This program is free software; you can redistribute it and/or modify
 * it under the terms of the GNU General Public License version 2 and
 * only version 2 as published by the Free Software Foundation.
 *
 * This program is distributed in the hope that it will be useful,
 * but WITHOUT ANY WARRANTY; without even the implied warranty of
 * MERCHANTABILITY or FITNESS FOR A PARTICULAR PURPOSE.  See the
 * GNU General Public License for more details.
 */

&usb_otg{
	interrupts = <0 134 0>,<0 140 0>,<0 136 0>;
	interrupt-names = "core_irq", "async_irq","phy_irq";

	qcom,hsusb-otg-mode = <3>;
	vbus_otg-supply = <&bq2560x_otg_supply>;
	qcom,hsusb-otg-phy-init-seq =
	<0x38 0x81 0xffffffff>;
};

&bq2560x_otg_supply {
	dpdm-supply = <&usb_otg>;
};

&usb_otg {
	extcon = <&bq2560x_otg_supply>;
};
