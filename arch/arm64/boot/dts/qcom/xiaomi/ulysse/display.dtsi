/*
 * Copyright (c) 2015-2016, The Linux Foundation. All rights reserved.
 * Copyright (C) 2018 XiaoMi, Inc.
 *
 * This program is free software; you can redistribute it and/or modify
 * it under the terms of the GNU General Public License version 2 and
 * only version 2 as published by the Free Software Foundation.
 *
 * This program is distributed in the hope that it will be useful,
 * but WITHOUT ANY WARRANTY; without even the implied warranty of
 * MERCHANTABILITY or FITNESS FOR A PARTICULAR PURPOSE.  See the
 * GNU General Public License for more details.
 */

#include "panels/dsi-panel-hx-otm1901a-720p-video.dtsi"
#include "panels/dsi-panel-shenchao-ili9881c-720p-video.dtsi"
#include "panels/dsi-panel-tm-otm1901a-720p-video.dtsi"

&mdss_dsi0 {
	qcom,regulator-ldo-mode;
	qcom,dsi-pref-prim-pan = <&dsi_sc_ili9881c_720p_video>;
	pinctrl-names = "mdss_default", "mdss_sleep";
	pinctrl-0 = <&mdss_dsi_active>;
	pinctrl-1 = <&mdss_dsi_suspend>;

	qcom,platform-reset-gpio = <&tlmm 60 0>;
	qcom,platform-bklight-en-gpio = <&tlmm 93 1>;
	/* lab-supply = <&tps65132_pos>;
	ibb-supply = <&tps65132_neg>; */
	qcom,ocp2131-enp-gpio = <&tlmm 12 0>;
	qcom,ocp2131-enn-gpio = <&tlmm 13 0>;
};

&mdss_fb0 {
	qcom,cont-splash-memory {
		linux,contiguous-region = <0xb4>;
	};
};
