#include "remove.dtsi"
#include "pinctrl.dtsi"

#include "audio.dtsi"
#include "battery.dtsi"
#include "display.dtsi"
#include "misc.dtsi"
#include "pm.dtsi"
#include "sdhc.dtsi"
#include "soc.dtsi"
#include "touchscreen.dtsi"
#include "usb.dtsi"
