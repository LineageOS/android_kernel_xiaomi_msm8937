/*
 * Copyright (c) 2015-2016, The Linux Foundation. All rights reserved.
 * Copyright (C) 2018 XiaoMi, Inc.
 *
 * This program is free software; you can redistribute it and/or modify
 * it under the terms of the GNU General Public License version 2 and
 * only version 2 as published by the Free Software Foundation.
 *
 * This program is distributed in the hope that it will be useful,
 * but WITHOUT ANY WARRANTY; without even the implied warranty of
 * MERCHANTABILITY or FITNESS FOR A PARTICULAR PURPOSE.  See the
 * GNU General Public License for more details.
 */

 &soc { /* Fingerprint */
	goodix_fp{
		compatible = "goodix,fingerprint";
		interrupt-parent = <&tlmm>;
		interrupt = <124 0x0>;
		vcc_spi_supply = <&pm8937_l6>;
		vcc_ana_supply = <&pm8937_l6>;
		vdd_io-supply = <&pm8937_l6>;
		goodix,gpio_reset = <&tlmm 132 0>;
		goodix,gpio_irq = <&tlmm 124 0>;
		goodix,gpio_ldo = <&tlmm 128 0>;
	};

	fpc1020 {
		status = "ok";
		compatible = "fpc,fpc1020";
		interrupt-parent = <&tlmm>;
		interrupts = <124 0x0>;
		fpc,gpio_rst    = <&tlmm 132 0x0>;
		fpc,gpio_irq    = <&tlmm 124 0x0>;
		vcc_spi-supply  = <&pm8937_l6>;
		vdd_io-supply   = <&pm8937_l6>;
		vdd_ana-supply  = <&pm8937_l6>;

		pinctrl-names = "fpc1020_reset_reset",
			"fpc1020_reset_active",
			"fpc1020_irq_active";

		pinctrl-0 = <&msm_gpio_132>;
		pinctrl-1 = <&msm_gpio_132_output_high>;
		pinctrl-2 = <&msm_gpio_124>;
	};

};
