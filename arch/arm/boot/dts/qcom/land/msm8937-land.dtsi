#include "msm8937-audio-land.dtsi"
#include "msm8937-camera-land.dtsi"
#include "msm8937-i2c-land.dtsi"
#include "msm8937-mdss-panels-land.dtsi"
#include "msm8937-memory-land.dtsi"
#include "msm8937-pinctrl-land.dtsi"
#include "msm8937-regulator-land.dtsi"
#include "msm8937-spi-land.dtsi"
#include "msm8937-spmi-land.dtsi"
