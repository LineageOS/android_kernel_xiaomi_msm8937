/*
 * Copyright (c) 2015-2016, The Linux Foundation. All rights reserved.
 *
 * This program is free software; you can redistribute it and/or modify
 * it under the terms of the GNU General Public License version 2 and
 * only version 2 as published by the Free Software Foundation.
 *
 * This program is distributed in the hope that it will be useful,
 * but WITHOUT ANY WARRANTY; without even the implied warranty of
 * MERCHANTABILITY or FITNESS FOR A PARTICULAR PURPOSE.  See the
 * GNU General Public License for more details.
 */

&pm8937_s2_level {
	regulator-max-microvolt =
		<RPM_SMD_REGULATOR_LEVEL_TURBO>;
};

&pm8937_s2_floor_level {
	regulator-max-microvolt =
		<RPM_SMD_REGULATOR_LEVEL_TURBO>;
};

&pm8937_s2_level_ao {
	regulator-max-microvolt =
		<RPM_SMD_REGULATOR_LEVEL_TURBO>;
};
